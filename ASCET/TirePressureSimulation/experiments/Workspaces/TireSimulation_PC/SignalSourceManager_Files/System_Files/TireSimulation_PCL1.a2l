ASAP2_VERSION 1 41
/begin PROJECT TireSimulation_PC "Generated by ETAS from Project TireSimulation_PC"
/begin HEADER "" VERSION "000" PROJECT_NO ASD /end HEADER
/begin MODULE TireSimulation_PC "Generated by ETAS ASCET7 from Project: TireSimulation_PC"
/begin IF_DATA E_TARGET
 /begin SOURCE "Task0" 3 /* period */ 10 QP_BLOB 1 /end SOURCE
 /begin TP_BLOB /* programm id */ 2936037348 /* target id */ 7 0 2 0 /end TP_BLOB
/end IF_DATA
/begin MOD_PAR "" VERSION "000" ADDR_EPK 0x0 EPK "" SUPPLIER "ETAS GmbH" CUSTOMER "xxx" CUSTOMER_NO "000" USER "xxx" PHONE_NO "000" ECU "PC" CPU_TYPE "PCx86" NO_OF_INTERFACES 1 /end MOD_PAR
/begin MOD_COMMON "Common definitions" BYTE_ORDER MSB_LAST ALIGNMENT_BYTE 1 ALIGNMENT_WORD 2 ALIGNMENT_LONG 4 ALIGNMENT_FLOAT32_IEEE 4 ALIGNMENT_FLOAT64_IEEE 8 /end MOD_COMMON
/begin CHARACTERISTIC components.Simulation.vfr "" VALUE 0x4342C4 STANDARD_VALUE_R32 0.0 esdl_ident -3.4028234663852886E+38 3.4028234663852886E+38 /end CHARACTERISTIC
/begin CHARACTERISTIC components.Simulation.vfl "" VALUE 0x4342C0 STANDARD_VALUE_R32 0.0 esdl_ident -3.4028234663852886E+38 3.4028234663852886E+38 /end CHARACTERISTIC
/begin CHARACTERISTIC components.Simulation.vrr "" VALUE 0x4342CC STANDARD_VALUE_R32 0.0 esdl_ident -3.4028234663852886E+38 3.4028234663852886E+38 /end CHARACTERISTIC
/begin CHARACTERISTIC components.Simulation.vrl "" VALUE 0x4342C8 STANDARD_VALUE_R32 0.0 esdl_ident -3.4028234663852886E+38 3.4028234663852886E+38 /end CHARACTERISTIC
/begin CHARACTERISTIC components.Simulation.status_tire "" VALUE 0x4342D0 STANDARD_VALUE_U8 0.0 esdl_ident 0 1 BIT_MASK 0x1 /end CHARACTERISTIC
/begin CHARACTERISTIC components.Simulation.RandomGenerator_instance_2.a "" VALUE 0x4342D8 STANDARD_VALUE_U16 0.0 esdl_ident 0 1009 /end CHARACTERISTIC
/begin CHARACTERISTIC components.Simulation.RandomGenerator_instance_2.m "" VALUE 0x4342DC STANDARD_VALUE_U16 0.0 esdl_ident 0 1009 /end CHARACTERISTIC
/begin CHARACTERISTIC components.Simulation.RandomGenerator_instance_2.crop "" VALUE 0x4342D4 STANDARD_VALUE_R32 0.0 esdl_ident -3.4028234663852886E+38 3.4028234663852886E+38 /end CHARACTERISTIC
/begin CHARACTERISTIC components.Simulation.RandomGenerator_instance_2.c "" VALUE 0x4342DA STANDARD_VALUE_U16 0.0 esdl_ident 0 1009 /end CHARACTERISTIC
/begin CHARACTERISTIC components.Simulation.RandomGenerator_instance_2.seed "" VALUE 0x4342DE STANDARD_VALUE_U16 0.0 esdl_ident 0 1009 /end CHARACTERISTIC
/begin CHARACTERISTIC components.sim_statemachine.failure "" VALUE 0x4510A0 STANDARD_VALUE_U8 0.0 esdl_ident 0 1 BIT_MASK 0x1 /end CHARACTERISTIC
/begin MEASUREMENT components.Simulation.sfl "" FLOAT32_IEEE esdl_ident 1 100.0 -3.4028234663852886E+38 3.4028234663852886E+38 ECU_ADDRESS 0x4340E4 /end MEASUREMENT
/begin MEASUREMENT components.Simulation.srl "" FLOAT32_IEEE esdl_ident 1 100.0 -3.4028234663852886E+38 3.4028234663852886E+38 ECU_ADDRESS 0x4340EC /end MEASUREMENT
/begin MEASUREMENT components.Simulation.srr "" FLOAT32_IEEE esdl_ident 1 100.0 -3.4028234663852886E+38 3.4028234663852886E+38 ECU_ADDRESS 0x4340F0 /end MEASUREMENT
/begin MEASUREMENT components.Simulation.sfr "" FLOAT32_IEEE esdl_ident 1 100.0 -3.4028234663852886E+38 3.4028234663852886E+38 ECU_ADDRESS 0x4340E8 /end MEASUREMENT
/begin MEASUREMENT components.Simulation.rand "" FLOAT32_IEEE esdl_ident 1 100.0 -3.4028234663852886E+38 3.4028234663852886E+38 ECU_ADDRESS 0x4340E0 /end MEASUREMENT
/begin MEASUREMENT components.Simulation.Model_instance.sfl "" FLOAT32_IEEE esdl_ident 1 100.0 -3.4028234663852886E+38 3.4028234663852886E+38 ECU_ADDRESS 0x43428C /end MEASUREMENT
/begin MEASUREMENT components.Simulation.Model_instance.sfr "" FLOAT32_IEEE esdl_ident 1 100.0 -3.4028234663852886E+38 3.4028234663852886E+38 ECU_ADDRESS 0x434290 /end MEASUREMENT
/begin MEASUREMENT components.Simulation.Model_instance.srl "" FLOAT32_IEEE esdl_ident 1 100.0 -3.4028234663852886E+38 3.4028234663852886E+38 ECU_ADDRESS 0x434294 /end MEASUREMENT
/begin MEASUREMENT components.Simulation.Model_instance.srr "" FLOAT32_IEEE esdl_ident 1 100.0 -3.4028234663852886E+38 3.4028234663852886E+38 ECU_ADDRESS 0x434298 /end MEASUREMENT
/begin MEASUREMENT components.Simulation.Model_instance.mem_dist "" FLOAT32_IEEE esdl_ident 1 100.0 -3.4028234663852886E+38 3.4028234663852886E+38 ECU_ADDRESS 0x4340F4 MATRIX_DIM 100 1 1 /end MEASUREMENT
/begin MEASUREMENT components.Simulation.Model_instance.read_index "" SLONG esdl_ident 1 100.0 -2147483648 2147483647 ECU_ADDRESS 0x434288 /end MEASUREMENT
/begin MEASUREMENT components.Simulation.Model_instance.mem_sfl "" FLOAT32_IEEE esdl_ident 1 100.0 -3.4028234663852886E+38 3.4028234663852886E+38 ECU_ADDRESS 0x434284 /end MEASUREMENT
/begin MEASUREMENT components.Simulation.Model_instance.write_index "" SLONG esdl_ident 1 100.0 -2147483648 2147483647 ECU_ADDRESS 0x43429C /end MEASUREMENT
/begin MEASUREMENT components.Simulation.RandomGenerator_instance_2.x "" UWORD esdl_ident 1 100.0 0 1009 ECU_ADDRESS 0x4342A0 /end MEASUREMENT
/begin MEASUREMENT components.sim_statemachine.SOS_state_instance.sm "" UBYTE esdl_components_SOS_stateStatemachineStates 1 100.0 0 4 ECU_ADDRESS 0x45109D /end MEASUREMENT
/begin MEASUREMENT components.sim_statemachine.SOS_state_instance.x "" SLONG esdl_ident 1 100.0 -2147483648 2147483647 ECU_ADDRESS 0x451094 /end MEASUREMENT
/begin MEASUREMENT components.sim_statemachine.SOS_state_instance.status "" SLONG esdl_ident 1 100.0 -2147483648 2147483647 ECU_ADDRESS 0x451090 /end MEASUREMENT
/begin MEASUREMENT components.sim_statemachine.SOS_state_instance.myDT "" FLOAT32_IEEE esdl_ident 1 100.0 -3.4028234663852886E+38 3.4028234663852886E+38 ECU_ADDRESS 0x451088 /end MEASUREMENT
/begin MEASUREMENT components.sim_statemachine.SOS_state_instance.duration "" FLOAT32_IEEE esdl_ident 1 100.0 -3.4028234663852886E+38 3.4028234663852886E+38 ECU_ADDRESS 0x451084 /end MEASUREMENT
/begin MEASUREMENT components.sim_statemachine.SOS_state_instance.y "" SLONG esdl_ident 1 100.0 -2147483648 2147483647 ECU_ADDRESS 0x451098 /end MEASUREMENT
/begin MEASUREMENT components.sim_statemachine.SOS_state_instance.run "" SLONG esdl_ident 1 100.0 -2147483648 2147483647 ECU_ADDRESS 0x45108C /end MEASUREMENT
/begin MEASUREMENT components.sim_statemachine.SOS_state_instance.aktiv "" UBYTE esdl_ident 1 100.0 0 1 ECU_ADDRESS 0x45109C BIT_MASK 0x1 /end MEASUREMENT
/begin COMPU_METHOD esdl_ident "" RAT_FUNC /* format */ "%12.4" /* unit */ "" /* coeffs */ COEFFS 0 1 0 0 0 1 /end COMPU_METHOD
/begin COMPU_METHOD esdl_components_SOS_stateStatemachineStates "" TAB_VERB /* format */ "%12.4" /* unit */ "" /* compu_tab_ref */ COMPU_TAB_REF esdl_components_SOS_stateStatemachineStates_vtab /end COMPU_METHOD
/begin COMPU_VTAB esdl_components_SOS_stateStatemachineStates_vtab "" TAB_VERB /* number value pairs */ 5 2 "beep_short" 4 "no_short" 1 "beep_long" 3 "no_long" 0 "off" /* default value */ DEFAULT_VALUE "Error" /end COMPU_VTAB
/begin FUNCTION TireSimulation_PC ""
 /begin SUB_FUNCTION components.Simulation components.Globals components.sim_statemachine /end SUB_FUNCTION
/end FUNCTION
/begin FUNCTION components.Simulation ""
 /begin DEF_CHARACTERISTIC components.Simulation.vfr components.Simulation.vfl components.Simulation.vrr components.Simulation.vrl components.Simulation.status_tire /end DEF_CHARACTERISTIC
 /begin LOC_MEASUREMENT components.Simulation.rand components.Simulation.sfl components.Simulation.sfr components.Simulation.srl components.Simulation.srr /end LOC_MEASUREMENT
 /begin SUB_FUNCTION components.Simulation.Model_instance components.Simulation.RandomGenerator_instance_2 /end SUB_FUNCTION
/end FUNCTION
/begin FUNCTION components.Simulation.Model_instance ""
 /begin LOC_MEASUREMENT components.Simulation.Model_instance.mem_dist components.Simulation.Model_instance.mem_sfl components.Simulation.Model_instance.read_index components.Simulation.Model_instance.sfl components.Simulation.Model_instance.sfr components.Simulation.Model_instance.srl components.Simulation.Model_instance.srr components.Simulation.Model_instance.write_index /end LOC_MEASUREMENT
/end FUNCTION
/begin FUNCTION components.Simulation.RandomGenerator_instance_2 ""
 /begin DEF_CHARACTERISTIC components.Simulation.RandomGenerator_instance_2.a components.Simulation.RandomGenerator_instance_2.m components.Simulation.RandomGenerator_instance_2.crop components.Simulation.RandomGenerator_instance_2.c components.Simulation.RandomGenerator_instance_2.seed /end DEF_CHARACTERISTIC
 /begin LOC_MEASUREMENT components.Simulation.RandomGenerator_instance_2.x /end LOC_MEASUREMENT
/end FUNCTION
/begin FUNCTION components.Globals "" /end FUNCTION
/begin FUNCTION components.sim_statemachine "" /begin DEF_CHARACTERISTIC components.sim_statemachine.failure /end DEF_CHARACTERISTIC /begin SUB_FUNCTION components.sim_statemachine.SOS_state_instance /end SUB_FUNCTION /end FUNCTION
/begin FUNCTION components.sim_statemachine.SOS_state_instance ""
 /begin LOC_MEASUREMENT components.sim_statemachine.SOS_state_instance.aktiv components.sim_statemachine.SOS_state_instance.duration components.sim_statemachine.SOS_state_instance.myDT components.sim_statemachine.SOS_state_instance.run components.sim_statemachine.SOS_state_instance.sm components.sim_statemachine.SOS_state_instance.status components.sim_statemachine.SOS_state_instance.x components.sim_statemachine.SOS_state_instance.y /end LOC_MEASUREMENT
/end FUNCTION
/begin RECORD_LAYOUT STANDARD_VALUE_R32 FNC_VALUES 1 FLOAT32_IEEE COLUMN_DIR DIRECT /end RECORD_LAYOUT
/begin RECORD_LAYOUT STANDARD_VALUE_U8 FNC_VALUES 1 UBYTE COLUMN_DIR DIRECT /end RECORD_LAYOUT
/begin RECORD_LAYOUT STANDARD_VALUE_U16 FNC_VALUES 1 UWORD COLUMN_DIR DIRECT /end RECORD_LAYOUT
/begin GROUP TireSimulation_PC "" ROOT
 /begin SUB_GROUP components.Simulation components.Globals components.sim_statemachine /end SUB_GROUP
/end GROUP
/begin GROUP components.Simulation ""
 /begin REF_CHARACTERISTIC components.Simulation.vfr components.Simulation.vfl components.Simulation.vrr components.Simulation.vrl components.Simulation.status_tire /end REF_CHARACTERISTIC
 /begin REF_MEASUREMENT components.Simulation.rand components.Simulation.sfl components.Simulation.sfr components.Simulation.srl components.Simulation.srr /end REF_MEASUREMENT
 /begin SUB_GROUP components.Simulation.Model_instance components.Simulation.RandomGenerator_instance_2 /end SUB_GROUP
/end GROUP
/begin GROUP components.Simulation.Model_instance ""
 /begin REF_MEASUREMENT components.Simulation.Model_instance.mem_dist components.Simulation.Model_instance.mem_sfl components.Simulation.Model_instance.read_index components.Simulation.Model_instance.sfl components.Simulation.Model_instance.sfr components.Simulation.Model_instance.srl components.Simulation.Model_instance.srr components.Simulation.Model_instance.write_index /end REF_MEASUREMENT
/end GROUP
/begin GROUP components.Simulation.RandomGenerator_instance_2 ""
 /begin REF_CHARACTERISTIC components.Simulation.RandomGenerator_instance_2.a components.Simulation.RandomGenerator_instance_2.m components.Simulation.RandomGenerator_instance_2.crop components.Simulation.RandomGenerator_instance_2.c components.Simulation.RandomGenerator_instance_2.seed /end REF_CHARACTERISTIC
 /begin REF_MEASUREMENT components.Simulation.RandomGenerator_instance_2.x /end REF_MEASUREMENT
/end GROUP
/begin GROUP components.Globals "" /end GROUP
/begin GROUP components.sim_statemachine "" /begin REF_CHARACTERISTIC components.sim_statemachine.failure /end REF_CHARACTERISTIC /begin SUB_GROUP components.sim_statemachine.SOS_state_instance /end SUB_GROUP /end GROUP
/begin GROUP components.sim_statemachine.SOS_state_instance ""
 /begin REF_MEASUREMENT components.sim_statemachine.SOS_state_instance.aktiv components.sim_statemachine.SOS_state_instance.duration components.sim_statemachine.SOS_state_instance.myDT components.sim_statemachine.SOS_state_instance.run components.sim_statemachine.SOS_state_instance.sm components.sim_statemachine.SOS_state_instance.status components.sim_statemachine.SOS_state_instance.x components.sim_statemachine.SOS_state_instance.y /end REF_MEASUREMENT
/end GROUP
/end MODULE
/end PROJECT
