ASAP2_VERSION 1 41
/begin PROJECT AscetTireSimApp "Generated by ETAS from Project AscetTireSimApp"
/begin HEADER "" VERSION "000" PROJECT_NO ASD /end HEADER
/begin MODULE AscetTireSimApp "Generated by ETAS ASCET7 from Project: AscetTireSimApp"
/begin IF_DATA E_TARGET
 /begin SOURCE "Task0" 3 /* period */ 10 QP_BLOB 1 /end SOURCE
 /begin TP_BLOB /* programm id */ 3187696792 /* target id */ 7 0 2 0 /end TP_BLOB
/end IF_DATA
/begin MOD_PAR "" VERSION "000" ADDR_EPK 0x0 EPK "" SUPPLIER "ETAS GmbH" CUSTOMER "xxx" CUSTOMER_NO "000" USER "xxx" PHONE_NO "000" ECU "PC" CPU_TYPE "PCx86" NO_OF_INTERFACES 1 /end MOD_PAR
/begin MOD_COMMON "Common definitions" BYTE_ORDER MSB_LAST ALIGNMENT_BYTE 1 ALIGNMENT_WORD 2 ALIGNMENT_LONG 4 ALIGNMENT_FLOAT32_IEEE 4 ALIGNMENT_FLOAT64_IEEE 8 /end MOD_COMMON
/begin CHARACTERISTIC components.sim_statemachine.failure "" VALUE 0x456FC0 STANDARD_VALUE_U8 0.0 esdl_ident 0 1 BIT_MASK 0x1 /end CHARACTERISTIC
/begin CHARACTERISTIC components.Simulation.status_tire "" VALUE 0x435008 STANDARD_VALUE_U8 0.0 esdl_ident 0 1 BIT_MASK 0x1 /end CHARACTERISTIC
/begin CHARACTERISTIC components.Simulation.base_v "" VALUE 0x435004 STANDARD_VALUE_R32 0.0 esdl_ident -3.4028234663852886E+38 3.4028234663852886E+38 /end CHARACTERISTIC
/begin CHARACTERISTIC components.Simulation.base_noiselevel "" VALUE 0x435000 STANDARD_VALUE_R32 0.0 esdl_ident -3.4028234663852886E+38 3.4028234663852886E+38 /end CHARACTERISTIC
/begin CHARACTERISTIC components.Simulation.RandomGenerator_instance.a "" VALUE 0x43500A STANDARD_VALUE_U16 0.0 esdl_ident 0 1024 /end CHARACTERISTIC
/begin CHARACTERISTIC components.Simulation.RandomGenerator_instance.m "" VALUE 0x43500E STANDARD_VALUE_U16 0.0 esdl_ident 0 1024 /end CHARACTERISTIC
/begin CHARACTERISTIC components.Simulation.RandomGenerator_instance.c "" VALUE 0x43500C STANDARD_VALUE_U16 0.0 esdl_ident 0 1024 /end CHARACTERISTIC
/begin CHARACTERISTIC components.Driver.base_v "" VALUE 0x435024 STANDARD_VALUE_R32 0.0 esdl_ident -3.4028234663852886E+38 3.4028234663852886E+38 /end CHARACTERISTIC
/begin CHARACTERISTIC components.Driver.base_noiselevel "" VALUE 0x435020 STANDARD_VALUE_R32 0.0 esdl_ident -3.4028234663852886E+38 3.4028234663852886E+38 /end CHARACTERISTIC
/begin CHARACTERISTIC components.Driver.deflate_fr "" VALUE 0x435029 STANDARD_VALUE_U8 0.0 esdl_ident 0 1 BIT_MASK 0x1 /end CHARACTERISTIC
/begin CHARACTERISTIC components.Driver.deflate_fl "" VALUE 0x435028 STANDARD_VALUE_U8 0.0 esdl_ident 0 1 BIT_MASK 0x1 /end CHARACTERISTIC
/begin CHARACTERISTIC components.Driver.deflate_vrl "" VALUE 0x43502A STANDARD_VALUE_U8 0.0 esdl_ident 0 1 BIT_MASK 0x1 /end CHARACTERISTIC
/begin CHARACTERISTIC components.Driver.deflate_vrr "" VALUE 0x43502B STANDARD_VALUE_U8 0.0 esdl_ident 0 1 BIT_MASK 0x1 /end CHARACTERISTIC
/begin CHARACTERISTIC components.Driver.RandomGenerator_instance.a "" VALUE 0x43502C STANDARD_VALUE_U16 0.0 esdl_ident 0 1024 /end CHARACTERISTIC
/begin CHARACTERISTIC components.Driver.RandomGenerator_instance.m "" VALUE 0x435030 STANDARD_VALUE_U16 0.0 esdl_ident 0 1024 /end CHARACTERISTIC
/begin CHARACTERISTIC components.Driver.RandomGenerator_instance.c "" VALUE 0x43502E STANDARD_VALUE_U16 0.0 esdl_ident 0 1024 /end CHARACTERISTIC
/begin CHARACTERISTIC components.Driver.RandomGenerator_instance_2.a "" VALUE 0x435032 STANDARD_VALUE_U16 0.0 esdl_ident 0 1024 /end CHARACTERISTIC
/begin CHARACTERISTIC components.Driver.RandomGenerator_instance_2.m "" VALUE 0x435036 STANDARD_VALUE_U16 0.0 esdl_ident 0 1024 /end CHARACTERISTIC
/begin CHARACTERISTIC components.Driver.RandomGenerator_instance_2.c "" VALUE 0x435034 STANDARD_VALUE_U16 0.0 esdl_ident 0 1024 /end CHARACTERISTIC
/begin CHARACTERISTIC components.Driver.RandomGenerator_instance_3.a "" VALUE 0x435038 STANDARD_VALUE_U16 0.0 esdl_ident 0 1024 /end CHARACTERISTIC
/begin CHARACTERISTIC components.Driver.RandomGenerator_instance_3.m "" VALUE 0x43503C STANDARD_VALUE_U16 0.0 esdl_ident 0 1024 /end CHARACTERISTIC
/begin CHARACTERISTIC components.Driver.RandomGenerator_instance_3.c "" VALUE 0x43503A STANDARD_VALUE_U16 0.0 esdl_ident 0 1024 /end CHARACTERISTIC
/begin CHARACTERISTIC components.Driver.RandomGenerator_instance_4.a "" VALUE 0x43503E STANDARD_VALUE_U16 0.0 esdl_ident 0 1024 /end CHARACTERISTIC
/begin CHARACTERISTIC components.Driver.RandomGenerator_instance_4.m "" VALUE 0x435042 STANDARD_VALUE_U16 0.0 esdl_ident 0 1024 /end CHARACTERISTIC
/begin CHARACTERISTIC components.Driver.RandomGenerator_instance_4.c "" VALUE 0x435040 STANDARD_VALUE_U16 0.0 esdl_ident 0 1024 /end CHARACTERISTIC
/begin MEASUREMENT components.sim_statemachine.SOS_state_instance.sm "" UBYTE esdl_components_SOS_stateStatemachineStates 1 100.0 0 4 ECU_ADDRESS 0x456FBD /end MEASUREMENT
/begin MEASUREMENT components.sim_statemachine.SOS_state_instance.x "" SLONG esdl_ident 1 100.0 -2147483648 2147483647 ECU_ADDRESS 0x456FB4 /end MEASUREMENT
/begin MEASUREMENT components.sim_statemachine.SOS_state_instance.status "" SLONG esdl_ident 1 100.0 -2147483648 2147483647 ECU_ADDRESS 0x456FB0 /end MEASUREMENT
/begin MEASUREMENT components.sim_statemachine.SOS_state_instance.myDT "" FLOAT32_IEEE esdl_ident 1 100.0 -3.4028234663852886E+38 3.4028234663852886E+38 ECU_ADDRESS 0x456FA4 /end MEASUREMENT
/begin MEASUREMENT components.sim_statemachine.SOS_state_instance.duration "" FLOAT32_IEEE esdl_ident 1 100.0 -3.4028234663852886E+38 3.4028234663852886E+38 ECU_ADDRESS 0x456FA0 /end MEASUREMENT
/begin MEASUREMENT components.sim_statemachine.SOS_state_instance.y "" SLONG esdl_ident 1 100.0 -2147483648 2147483647 ECU_ADDRESS 0x456FB8 /end MEASUREMENT
/begin MEASUREMENT components.sim_statemachine.SOS_state_instance.run "" SLONG esdl_ident 1 100.0 -2147483648 2147483647 ECU_ADDRESS 0x456FA8 /end MEASUREMENT
/begin MEASUREMENT components.sim_statemachine.SOS_state_instance.aktiv "" UBYTE esdl_ident 1 100.0 0 1 ECU_ADDRESS 0x456FBC BIT_MASK 0x1 /end MEASUREMENT
/begin MEASUREMENT components.sim_statemachine.SOS_state_instance.statelocation "" FLOAT32_IEEE esdl_ident 1 100.0 -3.4028234663852886E+38 3.4028234663852886E+38 ECU_ADDRESS 0x456FAC /end MEASUREMENT
/begin MEASUREMENT interfaces.interfaces.failure_detected "" UBYTE esdl_ident 1 100.0 0 1 ECU_ADDRESS 0x456F60 BIT_MASK 0x1 /end MEASUREMENT
/begin MEASUREMENT interfaces.interfaces.vfr "" FLOAT32_IEEE esdl_ident 1 100.0 -3.4028234663852886E+38 3.4028234663852886E+38 ECU_ADDRESS 0x456F6C /end MEASUREMENT
/begin MEASUREMENT interfaces.interfaces.vfl "" FLOAT32_IEEE esdl_ident 1 100.0 -3.4028234663852886E+38 3.4028234663852886E+38 ECU_ADDRESS 0x456F70 /end MEASUREMENT
/begin MEASUREMENT interfaces.interfaces.vrl "" FLOAT32_IEEE esdl_ident 1 100.0 -3.4028234663852886E+38 3.4028234663852886E+38 ECU_ADDRESS 0x456F68 /end MEASUREMENT
/begin MEASUREMENT interfaces.interfaces.vrr "" FLOAT32_IEEE esdl_ident 1 100.0 -3.4028234663852886E+38 3.4028234663852886E+38 ECU_ADDRESS 0x456F64 /end MEASUREMENT
/begin MEASUREMENT interfaces.interfaces.delta_sfr "" FLOAT32_IEEE esdl_ident 1 100.0 -3.4028234663852886E+38 3.4028234663852886E+38 ECU_ADDRESS 0x456F80 /end MEASUREMENT
/begin MEASUREMENT interfaces.interfaces.delta_sfl "" FLOAT32_IEEE esdl_ident 1 100.0 -3.4028234663852886E+38 3.4028234663852886E+38 ECU_ADDRESS 0x456F84 /end MEASUREMENT
/begin MEASUREMENT interfaces.interfaces.delta_srr "" FLOAT32_IEEE esdl_ident 1 100.0 -3.4028234663852886E+38 3.4028234663852886E+38 ECU_ADDRESS 0x456F78 /end MEASUREMENT
/begin MEASUREMENT interfaces.interfaces.delta_srl "" FLOAT32_IEEE esdl_ident 1 100.0 -3.4028234663852886E+38 3.4028234663852886E+38 ECU_ADDRESS 0x456F7C /end MEASUREMENT
/begin MEASUREMENT interfaces.interfaces.mean "" FLOAT32_IEEE esdl_ident 1 100.0 -3.4028234663852886E+38 3.4028234663852886E+38 ECU_ADDRESS 0x456F74 /end MEASUREMENT
/begin MEASUREMENT components.Globals.limit "" FLOAT32_IEEE esdl_ident 1 100.0 -3.4028234663852886E+38 3.4028234663852886E+38 ECU_ADDRESS 0x435010 /end MEASUREMENT
/begin MEASUREMENT components.Simulation.sfl "" FLOAT32_IEEE esdl_ident 1 100.0 -3.4028234663852886E+38 3.4028234663852886E+38 ECU_ADDRESS 0x453058 /end MEASUREMENT
/begin MEASUREMENT components.Simulation.srl "" FLOAT32_IEEE esdl_ident 1 100.0 -3.4028234663852886E+38 3.4028234663852886E+38 ECU_ADDRESS 0x453060 /end MEASUREMENT
/begin MEASUREMENT components.Simulation.srr "" FLOAT32_IEEE esdl_ident 1 100.0 -3.4028234663852886E+38 3.4028234663852886E+38 ECU_ADDRESS 0x453064 /end MEASUREMENT
/begin MEASUREMENT components.Simulation.sfr "" FLOAT32_IEEE esdl_ident 1 100.0 -3.4028234663852886E+38 3.4028234663852886E+38 ECU_ADDRESS 0x45305C /end MEASUREMENT
/begin MEASUREMENT components.Simulation.rand "" FLOAT32_IEEE esdl_ident 1 100.0 -3.4028234663852886E+38 3.4028234663852886E+38 ECU_ADDRESS 0x453054 /end MEASUREMENT
/begin MEASUREMENT components.Simulation.diff_sfl "" FLOAT32_IEEE esdl_ident 1 100.0 -3.4028234663852886E+38 3.4028234663852886E+38 ECU_ADDRESS 0x453040 /end MEASUREMENT
/begin MEASUREMENT components.Simulation.diff_sfr "" FLOAT32_IEEE esdl_ident 1 100.0 -3.4028234663852886E+38 3.4028234663852886E+38 ECU_ADDRESS 0x453044 /end MEASUREMENT
/begin MEASUREMENT components.Simulation.diff_srr "" FLOAT32_IEEE esdl_ident 1 100.0 -3.4028234663852886E+38 3.4028234663852886E+38 ECU_ADDRESS 0x45304C /end MEASUREMENT
/begin MEASUREMENT components.Simulation.diff_srl "" FLOAT32_IEEE esdl_ident 1 100.0 -3.4028234663852886E+38 3.4028234663852886E+38 ECU_ADDRESS 0x453048 /end MEASUREMENT
/begin MEASUREMENT components.Simulation.mean "" FLOAT32_IEEE esdl_ident 1 100.0 -3.4028234663852886E+38 3.4028234663852886E+38 ECU_ADDRESS 0x453050 /end MEASUREMENT
/begin MEASUREMENT components.Simulation.fl_failure "" UBYTE esdl_ident 1 100.0 0 1 ECU_ADDRESS 0x453078 BIT_MASK 0x1 /end MEASUREMENT
/begin MEASUREMENT components.Simulation.fr_failure "" UBYTE esdl_ident 1 100.0 0 1 ECU_ADDRESS 0x453079 BIT_MASK 0x1 /end MEASUREMENT
/begin MEASUREMENT components.Simulation.rl_failure "" UBYTE esdl_ident 1 100.0 0 1 ECU_ADDRESS 0x45307A BIT_MASK 0x1 /end MEASUREMENT
/begin MEASUREMENT components.Simulation.rr_failure "" UBYTE esdl_ident 1 100.0 0 1 ECU_ADDRESS 0x45307B BIT_MASK 0x1 /end MEASUREMENT
/begin MEASUREMENT components.Simulation.vfr "" FLOAT32_IEEE esdl_ident 1 100.0 -3.4028234663852886E+38 3.4028234663852886E+38 ECU_ADDRESS 0x45306C /end MEASUREMENT
/begin MEASUREMENT components.Simulation.vrr "" FLOAT32_IEEE esdl_ident 1 100.0 -3.4028234663852886E+38 3.4028234663852886E+38 ECU_ADDRESS 0x453074 /end MEASUREMENT
/begin MEASUREMENT components.Simulation.vfl "" FLOAT32_IEEE esdl_ident 1 100.0 -3.4028234663852886E+38 3.4028234663852886E+38 ECU_ADDRESS 0x453068 /end MEASUREMENT
/begin MEASUREMENT components.Simulation.vrl "" FLOAT32_IEEE esdl_ident 1 100.0 -3.4028234663852886E+38 3.4028234663852886E+38 ECU_ADDRESS 0x453070 /end MEASUREMENT
/begin MEASUREMENT components.Simulation.Model_instance.sfl "" FLOAT32_IEEE esdl_ident 1 100.0 -3.4028234663852886E+38 3.4028234663852886E+38 ECU_ADDRESS 0x45308C /end MEASUREMENT
/begin MEASUREMENT components.Simulation.Model_instance.sfr "" FLOAT32_IEEE esdl_ident 1 100.0 -3.4028234663852886E+38 3.4028234663852886E+38 ECU_ADDRESS 0x453094 /end MEASUREMENT
/begin MEASUREMENT components.Simulation.Model_instance.srl "" FLOAT32_IEEE esdl_ident 1 100.0 -3.4028234663852886E+38 3.4028234663852886E+38 ECU_ADDRESS 0x45309C /end MEASUREMENT
/begin MEASUREMENT components.Simulation.Model_instance.srr "" FLOAT32_IEEE esdl_ident 1 100.0 -3.4028234663852886E+38 3.4028234663852886E+38 ECU_ADDRESS 0x4530A4 /end MEASUREMENT
/begin MEASUREMENT components.Simulation.Model_instance.sfl_before "" FLOAT32_IEEE esdl_ident 1 100.0 -3.4028234663852886E+38 3.4028234663852886E+38 ECU_ADDRESS 0x453090 /end MEASUREMENT
/begin MEASUREMENT components.Simulation.Model_instance.sfr_before "" FLOAT32_IEEE esdl_ident 1 100.0 -3.4028234663852886E+38 3.4028234663852886E+38 ECU_ADDRESS 0x453098 /end MEASUREMENT
/begin MEASUREMENT components.Simulation.Model_instance.srl_before "" FLOAT32_IEEE esdl_ident 1 100.0 -3.4028234663852886E+38 3.4028234663852886E+38 ECU_ADDRESS 0x4530A0 /end MEASUREMENT
/begin MEASUREMENT components.Simulation.Model_instance.srr_before "" FLOAT32_IEEE esdl_ident 1 100.0 -3.4028234663852886E+38 3.4028234663852886E+38 ECU_ADDRESS 0x4530A8 /end MEASUREMENT
/begin MEASUREMENT components.Simulation.Model_instance.delta_sfl "" FLOAT32_IEEE esdl_ident 1 100.0 -3.4028234663852886E+38 3.4028234663852886E+38 ECU_ADDRESS 0x45307C /end MEASUREMENT
/begin MEASUREMENT components.Simulation.Model_instance.delta_sfr "" FLOAT32_IEEE esdl_ident 1 100.0 -3.4028234663852886E+38 3.4028234663852886E+38 ECU_ADDRESS 0x453080 /end MEASUREMENT
/begin MEASUREMENT components.Simulation.Model_instance.delta_srl "" FLOAT32_IEEE esdl_ident 1 100.0 -3.4028234663852886E+38 3.4028234663852886E+38 ECU_ADDRESS 0x453084 /end MEASUREMENT
/begin MEASUREMENT components.Simulation.Model_instance.delta_srr "" FLOAT32_IEEE esdl_ident 1 100.0 -3.4028234663852886E+38 3.4028234663852886E+38 ECU_ADDRESS 0x453088 /end MEASUREMENT
/begin MEASUREMENT components.Simulation.Model_instance.RingBuffer_instance.buffer "" FLOAT32_IEEE esdl_ident 1 100.0 -3.4028234663852886E+38 3.4028234663852886E+38 ECU_ADDRESS 0x4530AC MATRIX_DIM 1000 1 1 /end MEASUREMENT
/begin MEASUREMENT components.Simulation.Model_instance.RingBuffer_instance.c "" FLOAT32_IEEE esdl_ident 1 100.0 -3.4028234663852886E+38 3.4028234663852886E+38 ECU_ADDRESS 0x45404C /end MEASUREMENT
/begin MEASUREMENT components.Simulation.Model_instance.RingBuffer_instance.swap "" FLOAT32_IEEE esdl_ident 1 100.0 -3.4028234663852886E+38 3.4028234663852886E+38 ECU_ADDRESS 0x454050 /end MEASUREMENT
/begin MEASUREMENT components.Simulation.Model_instance.RingBuffer_instance_2.buffer "" FLOAT32_IEEE esdl_ident 1 100.0 -3.4028234663852886E+38 3.4028234663852886E+38 ECU_ADDRESS 0x454054 MATRIX_DIM 1000 1 1 /end MEASUREMENT
/begin MEASUREMENT components.Simulation.Model_instance.RingBuffer_instance_2.c "" FLOAT32_IEEE esdl_ident 1 100.0 -3.4028234663852886E+38 3.4028234663852886E+38 ECU_ADDRESS 0x454FF4 /end MEASUREMENT
/begin MEASUREMENT components.Simulation.Model_instance.RingBuffer_instance_2.swap "" FLOAT32_IEEE esdl_ident 1 100.0 -3.4028234663852886E+38 3.4028234663852886E+38 ECU_ADDRESS 0x454FF8 /end MEASUREMENT
/begin MEASUREMENT components.Simulation.Model_instance.RingBuffer_instance_3.buffer "" FLOAT32_IEEE esdl_ident 1 100.0 -3.4028234663852886E+38 3.4028234663852886E+38 ECU_ADDRESS 0x454FFC MATRIX_DIM 1000 1 1 /end MEASUREMENT
/begin MEASUREMENT components.Simulation.Model_instance.RingBuffer_instance_3.c "" FLOAT32_IEEE esdl_ident 1 100.0 -3.4028234663852886E+38 3.4028234663852886E+38 ECU_ADDRESS 0x455F9C /end MEASUREMENT
/begin MEASUREMENT components.Simulation.Model_instance.RingBuffer_instance_3.swap "" FLOAT32_IEEE esdl_ident 1 100.0 -3.4028234663852886E+38 3.4028234663852886E+38 ECU_ADDRESS 0x455FA0 /end MEASUREMENT
/begin MEASUREMENT components.Simulation.Model_instance.RingBuffer_instance_4.buffer "" FLOAT32_IEEE esdl_ident 1 100.0 -3.4028234663852886E+38 3.4028234663852886E+38 ECU_ADDRESS 0x455FA4 MATRIX_DIM 1000 1 1 /end MEASUREMENT
/begin MEASUREMENT components.Simulation.Model_instance.RingBuffer_instance_4.c "" FLOAT32_IEEE esdl_ident 1 100.0 -3.4028234663852886E+38 3.4028234663852886E+38 ECU_ADDRESS 0x456F44 /end MEASUREMENT
/begin MEASUREMENT components.Simulation.Model_instance.RingBuffer_instance_4.swap "" FLOAT32_IEEE esdl_ident 1 100.0 -3.4028234663852886E+38 3.4028234663852886E+38 ECU_ADDRESS 0x456F48 /end MEASUREMENT
/begin MEASUREMENT components.Simulation.TireDeviation_instance.v "" FLOAT32_IEEE esdl_ident 1 100.0 -3.4028234663852886E+38 3.4028234663852886E+38 ECU_ADDRESS 0x456F5C /end MEASUREMENT
/begin MEASUREMENT components.Simulation.TireDeviation_instance.mean "" FLOAT32_IEEE esdl_ident 1 100.0 -3.4028234663852886E+38 3.4028234663852886E+38 ECU_ADDRESS 0x456F58 /end MEASUREMENT
/begin MEASUREMENT components.Simulation.TireDeviation_instance.diff "" FLOAT32_IEEE esdl_ident 1 100.0 -3.4028234663852886E+38 3.4028234663852886E+38 ECU_ADDRESS 0x456F50 /end MEASUREMENT
/begin MEASUREMENT components.Simulation.TireDeviation_instance.limit "" FLOAT32_IEEE esdl_ident 1 100.0 -3.4028234663852886E+38 3.4028234663852886E+38 ECU_ADDRESS 0x456F54 /end MEASUREMENT
/begin MEASUREMENT components.Simulation.RandomGenerator_instance.seed "" UWORD esdl_ident 1 100.0 0 1024 ECU_ADDRESS 0x456F4C /end MEASUREMENT
/begin MEASUREMENT components.Simulation.RandomGenerator_instance.x "" UWORD esdl_ident 1 100.0 0 1024 ECU_ADDRESS 0x456F4E /end MEASUREMENT
/begin MEASUREMENT components.Driver.rand "" FLOAT32_IEEE esdl_ident 1 100.0 -3.4028234663852886E+38 3.4028234663852886E+38 ECU_ADDRESS 0x457060 /end MEASUREMENT
/begin MEASUREMENT components.Driver.RandomGenerator_instance.seed "" UWORD esdl_ident 1 100.0 0 1024 ECU_ADDRESS 0x457064 /end MEASUREMENT
/begin MEASUREMENT components.Driver.RandomGenerator_instance.x "" UWORD esdl_ident 1 100.0 0 1024 ECU_ADDRESS 0x457066 /end MEASUREMENT
/begin MEASUREMENT components.Driver.RandomGenerator_instance_2.seed "" UWORD esdl_ident 1 100.0 0 1024 ECU_ADDRESS 0x457068 /end MEASUREMENT
/begin MEASUREMENT components.Driver.RandomGenerator_instance_2.x "" UWORD esdl_ident 1 100.0 0 1024 ECU_ADDRESS 0x45706A /end MEASUREMENT
/begin MEASUREMENT components.Driver.RandomGenerator_instance_3.seed "" UWORD esdl_ident 1 100.0 0 1024 ECU_ADDRESS 0x45706C /end MEASUREMENT
/begin MEASUREMENT components.Driver.RandomGenerator_instance_3.x "" UWORD esdl_ident 1 100.0 0 1024 ECU_ADDRESS 0x45706E /end MEASUREMENT
/begin MEASUREMENT components.Driver.RandomGenerator_instance_4.seed "" UWORD esdl_ident 1 100.0 0 1024 ECU_ADDRESS 0x457070 /end MEASUREMENT
/begin MEASUREMENT components.Driver.RandomGenerator_instance_4.x "" UWORD esdl_ident 1 100.0 0 1024 ECU_ADDRESS 0x457072 /end MEASUREMENT
/begin MEASUREMENT components.TirePressureMonitoring.fr_failure "" UBYTE esdl_ident 1 100.0 0 1 ECU_ADDRESS 0x457001 BIT_MASK 0x1 /end MEASUREMENT
/begin MEASUREMENT components.TirePressureMonitoring.diff_sfr "" FLOAT32_IEEE esdl_ident 1 100.0 -3.4028234663852886E+38 3.4028234663852886E+38 ECU_ADDRESS 0x456FE4 /end MEASUREMENT
/begin MEASUREMENT components.TirePressureMonitoring.diff_sfl "" FLOAT32_IEEE esdl_ident 1 100.0 -3.4028234663852886E+38 3.4028234663852886E+38 ECU_ADDRESS 0x456FE0 /end MEASUREMENT
/begin MEASUREMENT components.TirePressureMonitoring.diff_srl "" FLOAT32_IEEE esdl_ident 1 100.0 -3.4028234663852886E+38 3.4028234663852886E+38 ECU_ADDRESS 0x456FE8 /end MEASUREMENT
/begin MEASUREMENT components.TirePressureMonitoring.rr_failure "" UBYTE esdl_ident 1 100.0 0 1 ECU_ADDRESS 0x457003 BIT_MASK 0x1 /end MEASUREMENT
/begin MEASUREMENT components.TirePressureMonitoring.rl_failure "" UBYTE esdl_ident 1 100.0 0 1 ECU_ADDRESS 0x457002 BIT_MASK 0x1 /end MEASUREMENT
/begin MEASUREMENT components.TirePressureMonitoring.diff_srr "" FLOAT32_IEEE esdl_ident 1 100.0 -3.4028234663852886E+38 3.4028234663852886E+38 ECU_ADDRESS 0x456FEC /end MEASUREMENT
/begin MEASUREMENT components.TirePressureMonitoring.fl_failure "" UBYTE esdl_ident 1 100.0 0 1 ECU_ADDRESS 0x457000 BIT_MASK 0x1 /end MEASUREMENT
/begin MEASUREMENT components.TirePressureMonitoring.mean_exRl "" FLOAT32_IEEE esdl_ident 1 100.0 -3.4028234663852886E+38 3.4028234663852886E+38 ECU_ADDRESS 0x456FF8 /end MEASUREMENT
/begin MEASUREMENT components.TirePressureMonitoring.mean_exFl "" FLOAT32_IEEE esdl_ident 1 100.0 -3.4028234663852886E+38 3.4028234663852886E+38 ECU_ADDRESS 0x456FF0 /end MEASUREMENT
/begin MEASUREMENT components.TirePressureMonitoring.mean_exFr "" FLOAT32_IEEE esdl_ident 1 100.0 -3.4028234663852886E+38 3.4028234663852886E+38 ECU_ADDRESS 0x456FF4 /end MEASUREMENT
/begin MEASUREMENT components.TirePressureMonitoring.mean_exRr "" FLOAT32_IEEE esdl_ident 1 100.0 -3.4028234663852886E+38 3.4028234663852886E+38 ECU_ADDRESS 0x456FFC /end MEASUREMENT
/begin MEASUREMENT components.TirePressureMonitoring.TireDeviation_instance.v "" FLOAT32_IEEE esdl_ident 1 100.0 -3.4028234663852886E+38 3.4028234663852886E+38 ECU_ADDRESS 0x457010 /end MEASUREMENT
/begin MEASUREMENT components.TirePressureMonitoring.TireDeviation_instance.mean "" FLOAT32_IEEE esdl_ident 1 100.0 -3.4028234663852886E+38 3.4028234663852886E+38 ECU_ADDRESS 0x45700C /end MEASUREMENT
/begin MEASUREMENT components.TirePressureMonitoring.TireDeviation_instance.diff "" FLOAT32_IEEE esdl_ident 1 100.0 -3.4028234663852886E+38 3.4028234663852886E+38 ECU_ADDRESS 0x457004 /end MEASUREMENT
/begin MEASUREMENT components.TirePressureMonitoring.TireDeviation_instance.limit "" FLOAT32_IEEE esdl_ident 1 100.0 -3.4028234663852886E+38 3.4028234663852886E+38 ECU_ADDRESS 0x457008 /end MEASUREMENT
/begin MEASUREMENT components.TirePressureMonitoring.TireDeviation_instance_2.v "" FLOAT32_IEEE esdl_ident 1 100.0 -3.4028234663852886E+38 3.4028234663852886E+38 ECU_ADDRESS 0x457020 /end MEASUREMENT
/begin MEASUREMENT components.TirePressureMonitoring.TireDeviation_instance_2.mean "" FLOAT32_IEEE esdl_ident 1 100.0 -3.4028234663852886E+38 3.4028234663852886E+38 ECU_ADDRESS 0x45701C /end MEASUREMENT
/begin MEASUREMENT components.TirePressureMonitoring.TireDeviation_instance_2.diff "" FLOAT32_IEEE esdl_ident 1 100.0 -3.4028234663852886E+38 3.4028234663852886E+38 ECU_ADDRESS 0x457014 /end MEASUREMENT
/begin MEASUREMENT components.TirePressureMonitoring.TireDeviation_instance_2.limit "" FLOAT32_IEEE esdl_ident 1 100.0 -3.4028234663852886E+38 3.4028234663852886E+38 ECU_ADDRESS 0x457018 /end MEASUREMENT
/begin MEASUREMENT components.TirePressureMonitoring.TireDeviation_instance_3.v "" FLOAT32_IEEE esdl_ident 1 100.0 -3.4028234663852886E+38 3.4028234663852886E+38 ECU_ADDRESS 0x457030 /end MEASUREMENT
/begin MEASUREMENT components.TirePressureMonitoring.TireDeviation_instance_3.mean "" FLOAT32_IEEE esdl_ident 1 100.0 -3.4028234663852886E+38 3.4028234663852886E+38 ECU_ADDRESS 0x45702C /end MEASUREMENT
/begin MEASUREMENT components.TirePressureMonitoring.TireDeviation_instance_3.diff "" FLOAT32_IEEE esdl_ident 1 100.0 -3.4028234663852886E+38 3.4028234663852886E+38 ECU_ADDRESS 0x457024 /end MEASUREMENT
/begin MEASUREMENT components.TirePressureMonitoring.TireDeviation_instance_3.limit "" FLOAT32_IEEE esdl_ident 1 100.0 -3.4028234663852886E+38 3.4028234663852886E+38 ECU_ADDRESS 0x457028 /end MEASUREMENT
/begin MEASUREMENT components.TirePressureMonitoring.TireDeviation_instance_4.v "" FLOAT32_IEEE esdl_ident 1 100.0 -3.4028234663852886E+38 3.4028234663852886E+38 ECU_ADDRESS 0x457040 /end MEASUREMENT
/begin MEASUREMENT components.TirePressureMonitoring.TireDeviation_instance_4.mean "" FLOAT32_IEEE esdl_ident 1 100.0 -3.4028234663852886E+38 3.4028234663852886E+38 ECU_ADDRESS 0x45703C /end MEASUREMENT
/begin MEASUREMENT components.TirePressureMonitoring.TireDeviation_instance_4.diff "" FLOAT32_IEEE esdl_ident 1 100.0 -3.4028234663852886E+38 3.4028234663852886E+38 ECU_ADDRESS 0x457034 /end MEASUREMENT
/begin MEASUREMENT components.TirePressureMonitoring.TireDeviation_instance_4.limit "" FLOAT32_IEEE esdl_ident 1 100.0 -3.4028234663852886E+38 3.4028234663852886E+38 ECU_ADDRESS 0x457038 /end MEASUREMENT
/begin COMPU_METHOD esdl_components_SOS_stateStatemachineStates "" TAB_VERB /* format */ "%12.4" /* unit */ "" /* compu_tab_ref */ COMPU_TAB_REF esdl_components_SOS_stateStatemachineStates_vtab /end COMPU_METHOD
/begin COMPU_VTAB esdl_components_SOS_stateStatemachineStates_vtab "" TAB_VERB /* number value pairs */ 5 2 "beep_short" 4 "no_short" 1 "beep_long" 3 "no_long" 0 "off" /* default value */ DEFAULT_VALUE "Error" /end COMPU_VTAB
/begin COMPU_METHOD esdl_ident "" RAT_FUNC /* format */ "%12.4" /* unit */ "" /* coeffs */ COEFFS 0 1 0 0 0 1 /end COMPU_METHOD
/begin FUNCTION AscetTireSimApp ""
 /begin SUB_FUNCTION components.sim_statemachine components.Globals components.Simulation components.Driver components.TirePressureMonitoring /end SUB_FUNCTION
/end FUNCTION
/begin FUNCTION components.sim_statemachine "" /begin DEF_CHARACTERISTIC components.sim_statemachine.failure /end DEF_CHARACTERISTIC /begin IN_MEASUREMENT interfaces.interfaces.failure_detected /end IN_MEASUREMENT /begin SUB_FUNCTION components.sim_statemachine.SOS_state_instance /end SUB_FUNCTION /end FUNCTION
/begin FUNCTION components.sim_statemachine.SOS_state_instance ""
 /begin LOC_MEASUREMENT components.sim_statemachine.SOS_state_instance.aktiv components.sim_statemachine.SOS_state_instance.duration components.sim_statemachine.SOS_state_instance.myDT components.sim_statemachine.SOS_state_instance.run components.sim_statemachine.SOS_state_instance.sm components.sim_statemachine.SOS_state_instance.statelocation components.sim_statemachine.SOS_state_instance.status components.sim_statemachine.SOS_state_instance.x components.sim_statemachine.SOS_state_instance.y /end LOC_MEASUREMENT
/end FUNCTION
/begin FUNCTION components.Globals "" /begin LOC_MEASUREMENT components.Globals.limit /end LOC_MEASUREMENT /end FUNCTION
/begin FUNCTION components.Simulation ""
 /begin DEF_CHARACTERISTIC components.Simulation.status_tire components.Simulation.base_v components.Simulation.base_noiselevel /end DEF_CHARACTERISTIC
 /begin IN_MEASUREMENT interfaces.interfaces.vfl interfaces.interfaces.vfr interfaces.interfaces.vrl interfaces.interfaces.vrr /end IN_MEASUREMENT
 /begin OUT_MEASUREMENT interfaces.interfaces.delta_sfl interfaces.interfaces.delta_sfr interfaces.interfaces.delta_srl interfaces.interfaces.delta_srr interfaces.interfaces.failure_detected /end OUT_MEASUREMENT
 /begin LOC_MEASUREMENT components.Simulation.diff_sfl components.Simulation.diff_sfr components.Simulation.diff_srl components.Simulation.diff_srr components.Simulation.fl_failure components.Simulation.fr_failure components.Simulation.mean components.Simulation.rand components.Simulation.rl_failure components.Simulation.rr_failure components.Simulation.sfl components.Simulation.sfr components.Simulation.srl components.Simulation.srr components.Simulation.vfl components.Simulation.vfr components.Simulation.vrl components.Simulation.vrr /end LOC_MEASUREMENT
 /begin SUB_FUNCTION components.Simulation.Model_instance components.Simulation.TireMean_instance components.Simulation.TireDeviation_instance components.Simulation.RandomGenerator_instance /end SUB_FUNCTION
/end FUNCTION
/begin FUNCTION components.Simulation.Model_instance ""
 /begin LOC_MEASUREMENT components.Simulation.Model_instance.delta_sfl components.Simulation.Model_instance.delta_sfr components.Simulation.Model_instance.delta_srl components.Simulation.Model_instance.delta_srr components.Simulation.Model_instance.sfl components.Simulation.Model_instance.sfl_before components.Simulation.Model_instance.sfr components.Simulation.Model_instance.sfr_before components.Simulation.Model_instance.srl components.Simulation.Model_instance.srl_before components.Simulation.Model_instance.srr components.Simulation.Model_instance.srr_before /end LOC_MEASUREMENT
 /begin SUB_FUNCTION components.Simulation.Model_instance.RingBuffer_instance components.Simulation.Model_instance.RingBuffer_instance_2 components.Simulation.Model_instance.RingBuffer_instance_3 components.Simulation.Model_instance.RingBuffer_instance_4 /end SUB_FUNCTION
/end FUNCTION
/begin FUNCTION components.Simulation.Model_instance.RingBuffer_instance ""
 /begin LOC_MEASUREMENT components.Simulation.Model_instance.RingBuffer_instance.buffer components.Simulation.Model_instance.RingBuffer_instance.c components.Simulation.Model_instance.RingBuffer_instance.swap /end LOC_MEASUREMENT
/end FUNCTION
/begin FUNCTION components.Simulation.Model_instance.RingBuffer_instance_2 ""
 /begin LOC_MEASUREMENT components.Simulation.Model_instance.RingBuffer_instance_2.buffer components.Simulation.Model_instance.RingBuffer_instance_2.c components.Simulation.Model_instance.RingBuffer_instance_2.swap /end LOC_MEASUREMENT
/end FUNCTION
/begin FUNCTION components.Simulation.Model_instance.RingBuffer_instance_3 ""
 /begin LOC_MEASUREMENT components.Simulation.Model_instance.RingBuffer_instance_3.buffer components.Simulation.Model_instance.RingBuffer_instance_3.c components.Simulation.Model_instance.RingBuffer_instance_3.swap /end LOC_MEASUREMENT
/end FUNCTION
/begin FUNCTION components.Simulation.Model_instance.RingBuffer_instance_4 ""
 /begin LOC_MEASUREMENT components.Simulation.Model_instance.RingBuffer_instance_4.buffer components.Simulation.Model_instance.RingBuffer_instance_4.c components.Simulation.Model_instance.RingBuffer_instance_4.swap /end LOC_MEASUREMENT
/end FUNCTION
/begin FUNCTION components.Simulation.TireMean_instance "" /end FUNCTION
/begin FUNCTION components.Simulation.TireDeviation_instance ""
 /begin LOC_MEASUREMENT components.Simulation.TireDeviation_instance.diff components.Simulation.TireDeviation_instance.limit components.Simulation.TireDeviation_instance.mean components.Simulation.TireDeviation_instance.v /end LOC_MEASUREMENT
/end FUNCTION
/begin FUNCTION components.Simulation.RandomGenerator_instance ""
 /begin DEF_CHARACTERISTIC components.Simulation.RandomGenerator_instance.a components.Simulation.RandomGenerator_instance.m components.Simulation.RandomGenerator_instance.c /end DEF_CHARACTERISTIC
 /begin LOC_MEASUREMENT components.Simulation.RandomGenerator_instance.seed components.Simulation.RandomGenerator_instance.x /end LOC_MEASUREMENT
/end FUNCTION
/begin FUNCTION components.Driver ""
 /begin DEF_CHARACTERISTIC components.Driver.base_v components.Driver.base_noiselevel components.Driver.deflate_fr components.Driver.deflate_fl components.Driver.deflate_vrl components.Driver.deflate_vrr /end DEF_CHARACTERISTIC
 /begin IN_MEASUREMENT interfaces.interfaces.mean /end IN_MEASUREMENT
 /begin OUT_MEASUREMENT interfaces.interfaces.vfl interfaces.interfaces.vfr interfaces.interfaces.vrl interfaces.interfaces.vrr /end OUT_MEASUREMENT
 /begin LOC_MEASUREMENT components.Driver.rand /end LOC_MEASUREMENT
 /begin SUB_FUNCTION components.Driver.RandomGenerator_instance components.Driver.RandomGenerator_instance_2 components.Driver.RandomGenerator_instance_3 components.Driver.RandomGenerator_instance_4 components.Driver.CalcDiviation_instance components.Driver.CalcDiviation_instance_2 components.Driver.CalcDiviation_instance_3 components.Driver.CalcDiviation_instance_4 /end SUB_FUNCTION
/end FUNCTION
/begin FUNCTION components.Driver.RandomGenerator_instance ""
 /begin DEF_CHARACTERISTIC components.Driver.RandomGenerator_instance.a components.Driver.RandomGenerator_instance.m components.Driver.RandomGenerator_instance.c /end DEF_CHARACTERISTIC
 /begin LOC_MEASUREMENT components.Driver.RandomGenerator_instance.seed components.Driver.RandomGenerator_instance.x /end LOC_MEASUREMENT
/end FUNCTION
/begin FUNCTION components.Driver.RandomGenerator_instance_2 ""
 /begin DEF_CHARACTERISTIC components.Driver.RandomGenerator_instance_2.a components.Driver.RandomGenerator_instance_2.m components.Driver.RandomGenerator_instance_2.c /end DEF_CHARACTERISTIC
 /begin LOC_MEASUREMENT components.Driver.RandomGenerator_instance_2.seed components.Driver.RandomGenerator_instance_2.x /end LOC_MEASUREMENT
/end FUNCTION
/begin FUNCTION components.Driver.RandomGenerator_instance_3 ""
 /begin DEF_CHARACTERISTIC components.Driver.RandomGenerator_instance_3.a components.Driver.RandomGenerator_instance_3.m components.Driver.RandomGenerator_instance_3.c /end DEF_CHARACTERISTIC
 /begin LOC_MEASUREMENT components.Driver.RandomGenerator_instance_3.seed components.Driver.RandomGenerator_instance_3.x /end LOC_MEASUREMENT
/end FUNCTION
/begin FUNCTION components.Driver.RandomGenerator_instance_4 ""
 /begin DEF_CHARACTERISTIC components.Driver.RandomGenerator_instance_4.a components.Driver.RandomGenerator_instance_4.m components.Driver.RandomGenerator_instance_4.c /end DEF_CHARACTERISTIC
 /begin LOC_MEASUREMENT components.Driver.RandomGenerator_instance_4.seed components.Driver.RandomGenerator_instance_4.x /end LOC_MEASUREMENT
/end FUNCTION
/begin FUNCTION components.Driver.CalcDiviation_instance "" /end FUNCTION
/begin FUNCTION components.Driver.CalcDiviation_instance_2 "" /end FUNCTION
/begin FUNCTION components.Driver.CalcDiviation_instance_3 "" /end FUNCTION
/begin FUNCTION components.Driver.CalcDiviation_instance_4 "" /end FUNCTION
/begin FUNCTION components.TirePressureMonitoring ""
 /begin IN_MEASUREMENT interfaces.interfaces.delta_sfl interfaces.interfaces.delta_sfr interfaces.interfaces.delta_srl interfaces.interfaces.delta_srr /end IN_MEASUREMENT
 /begin OUT_MEASUREMENT interfaces.interfaces.failure_detected /end OUT_MEASUREMENT
 /begin LOC_MEASUREMENT components.TirePressureMonitoring.diff_sfl components.TirePressureMonitoring.diff_sfr components.TirePressureMonitoring.diff_srl components.TirePressureMonitoring.diff_srr components.TirePressureMonitoring.fl_failure components.TirePressureMonitoring.fr_failure components.TirePressureMonitoring.mean_exFl components.TirePressureMonitoring.mean_exFr components.TirePressureMonitoring.mean_exRl components.TirePressureMonitoring.mean_exRr components.TirePressureMonitoring.rl_failure components.TirePressureMonitoring.rr_failure /end LOC_MEASUREMENT
 /begin SUB_FUNCTION components.TirePressureMonitoring.TireDeviation_instance components.TirePressureMonitoring.TireDeviation_instance_2 components.TirePressureMonitoring.TireDeviation_instance_3 components.TirePressureMonitoring.TireDeviation_instance_4 components.TirePressureMonitoring.TireMean_instance components.TirePressureMonitoring.TireMean_instance_2 components.TirePressureMonitoring.TireMean_instance_3 components.TirePressureMonitoring.TireMean_instance_4 /end SUB_FUNCTION
/end FUNCTION
/begin FUNCTION components.TirePressureMonitoring.TireDeviation_instance ""
 /begin LOC_MEASUREMENT components.TirePressureMonitoring.TireDeviation_instance.diff components.TirePressureMonitoring.TireDeviation_instance.limit components.TirePressureMonitoring.TireDeviation_instance.mean components.TirePressureMonitoring.TireDeviation_instance.v /end LOC_MEASUREMENT
/end FUNCTION
/begin FUNCTION components.TirePressureMonitoring.TireDeviation_instance_2 ""
 /begin LOC_MEASUREMENT components.TirePressureMonitoring.TireDeviation_instance_2.diff components.TirePressureMonitoring.TireDeviation_instance_2.limit components.TirePressureMonitoring.TireDeviation_instance_2.mean components.TirePressureMonitoring.TireDeviation_instance_2.v /end LOC_MEASUREMENT
/end FUNCTION
/begin FUNCTION components.TirePressureMonitoring.TireDeviation_instance_3 ""
 /begin LOC_MEASUREMENT components.TirePressureMonitoring.TireDeviation_instance_3.diff components.TirePressureMonitoring.TireDeviation_instance_3.limit components.TirePressureMonitoring.TireDeviation_instance_3.mean components.TirePressureMonitoring.TireDeviation_instance_3.v /end LOC_MEASUREMENT
/end FUNCTION
/begin FUNCTION components.TirePressureMonitoring.TireDeviation_instance_4 ""
 /begin LOC_MEASUREMENT components.TirePressureMonitoring.TireDeviation_instance_4.diff components.TirePressureMonitoring.TireDeviation_instance_4.limit components.TirePressureMonitoring.TireDeviation_instance_4.mean components.TirePressureMonitoring.TireDeviation_instance_4.v /end LOC_MEASUREMENT
/end FUNCTION
/begin FUNCTION components.TirePressureMonitoring.TireMean_instance "" /end FUNCTION
/begin FUNCTION components.TirePressureMonitoring.TireMean_instance_2 "" /end FUNCTION
/begin FUNCTION components.TirePressureMonitoring.TireMean_instance_3 "" /end FUNCTION
/begin FUNCTION components.TirePressureMonitoring.TireMean_instance_4 "" /end FUNCTION
/begin RECORD_LAYOUT STANDARD_VALUE_U8 FNC_VALUES 1 UBYTE COLUMN_DIR DIRECT /end RECORD_LAYOUT
/begin RECORD_LAYOUT STANDARD_VALUE_R32 FNC_VALUES 1 FLOAT32_IEEE COLUMN_DIR DIRECT /end RECORD_LAYOUT
/begin RECORD_LAYOUT STANDARD_VALUE_U16 FNC_VALUES 1 UWORD COLUMN_DIR DIRECT /end RECORD_LAYOUT
/begin GROUP AscetTireSimApp "" ROOT
 /begin SUB_GROUP components.sim_statemachine interfaces.interfaces components.Globals components.Simulation components.Driver components.TirePressureMonitoring /end SUB_GROUP
/end GROUP
/begin GROUP components.sim_statemachine "" /begin REF_CHARACTERISTIC components.sim_statemachine.failure /end REF_CHARACTERISTIC /begin SUB_GROUP components.sim_statemachine.SOS_state_instance /end SUB_GROUP /end GROUP
/begin GROUP components.sim_statemachine.SOS_state_instance ""
 /begin REF_MEASUREMENT components.sim_statemachine.SOS_state_instance.aktiv components.sim_statemachine.SOS_state_instance.duration components.sim_statemachine.SOS_state_instance.myDT components.sim_statemachine.SOS_state_instance.run components.sim_statemachine.SOS_state_instance.sm components.sim_statemachine.SOS_state_instance.statelocation components.sim_statemachine.SOS_state_instance.status components.sim_statemachine.SOS_state_instance.x components.sim_statemachine.SOS_state_instance.y /end REF_MEASUREMENT
/end GROUP
/begin GROUP interfaces.interfaces ""
 /begin REF_MEASUREMENT interfaces.interfaces.delta_sfl interfaces.interfaces.delta_sfr interfaces.interfaces.delta_srl interfaces.interfaces.delta_srr interfaces.interfaces.failure_detected interfaces.interfaces.mean interfaces.interfaces.vfl interfaces.interfaces.vfr interfaces.interfaces.vrl interfaces.interfaces.vrr /end REF_MEASUREMENT
/end GROUP
/begin GROUP components.Globals "" /begin REF_MEASUREMENT components.Globals.limit /end REF_MEASUREMENT /end GROUP
/begin GROUP components.Simulation ""
 /begin REF_CHARACTERISTIC components.Simulation.status_tire components.Simulation.base_v components.Simulation.base_noiselevel /end REF_CHARACTERISTIC
 /begin REF_MEASUREMENT components.Simulation.diff_sfl components.Simulation.diff_sfr components.Simulation.diff_srl components.Simulation.diff_srr components.Simulation.fl_failure components.Simulation.fr_failure components.Simulation.mean components.Simulation.rand components.Simulation.rl_failure components.Simulation.rr_failure components.Simulation.sfl components.Simulation.sfr components.Simulation.srl components.Simulation.srr components.Simulation.vfl components.Simulation.vfr components.Simulation.vrl components.Simulation.vrr /end REF_MEASUREMENT
 /begin SUB_GROUP components.Simulation.Model_instance components.Simulation.TireMean_instance components.Simulation.TireDeviation_instance components.Simulation.RandomGenerator_instance /end SUB_GROUP
/end GROUP
/begin GROUP components.Simulation.Model_instance ""
 /begin REF_MEASUREMENT components.Simulation.Model_instance.delta_sfl components.Simulation.Model_instance.delta_sfr components.Simulation.Model_instance.delta_srl components.Simulation.Model_instance.delta_srr components.Simulation.Model_instance.sfl components.Simulation.Model_instance.sfl_before components.Simulation.Model_instance.sfr components.Simulation.Model_instance.sfr_before components.Simulation.Model_instance.srl components.Simulation.Model_instance.srl_before components.Simulation.Model_instance.srr components.Simulation.Model_instance.srr_before /end REF_MEASUREMENT
 /begin SUB_GROUP components.Simulation.Model_instance.RingBuffer_instance components.Simulation.Model_instance.RingBuffer_instance_2 components.Simulation.Model_instance.RingBuffer_instance_3 components.Simulation.Model_instance.RingBuffer_instance_4 /end SUB_GROUP
/end GROUP
/begin GROUP components.Simulation.Model_instance.RingBuffer_instance ""
 /begin REF_MEASUREMENT components.Simulation.Model_instance.RingBuffer_instance.buffer components.Simulation.Model_instance.RingBuffer_instance.c components.Simulation.Model_instance.RingBuffer_instance.swap /end REF_MEASUREMENT
/end GROUP
/begin GROUP components.Simulation.Model_instance.RingBuffer_instance_2 ""
 /begin REF_MEASUREMENT components.Simulation.Model_instance.RingBuffer_instance_2.buffer components.Simulation.Model_instance.RingBuffer_instance_2.c components.Simulation.Model_instance.RingBuffer_instance_2.swap /end REF_MEASUREMENT
/end GROUP
/begin GROUP components.Simulation.Model_instance.RingBuffer_instance_3 ""
 /begin REF_MEASUREMENT components.Simulation.Model_instance.RingBuffer_instance_3.buffer components.Simulation.Model_instance.RingBuffer_instance_3.c components.Simulation.Model_instance.RingBuffer_instance_3.swap /end REF_MEASUREMENT
/end GROUP
/begin GROUP components.Simulation.Model_instance.RingBuffer_instance_4 ""
 /begin REF_MEASUREMENT components.Simulation.Model_instance.RingBuffer_instance_4.buffer components.Simulation.Model_instance.RingBuffer_instance_4.c components.Simulation.Model_instance.RingBuffer_instance_4.swap /end REF_MEASUREMENT
/end GROUP
/begin GROUP components.Simulation.TireMean_instance "" /end GROUP
/begin GROUP components.Simulation.TireDeviation_instance ""
 /begin REF_MEASUREMENT components.Simulation.TireDeviation_instance.diff components.Simulation.TireDeviation_instance.limit components.Simulation.TireDeviation_instance.mean components.Simulation.TireDeviation_instance.v /end REF_MEASUREMENT
/end GROUP
/begin GROUP components.Simulation.RandomGenerator_instance ""
 /begin REF_CHARACTERISTIC components.Simulation.RandomGenerator_instance.a components.Simulation.RandomGenerator_instance.m components.Simulation.RandomGenerator_instance.c /end REF_CHARACTERISTIC
 /begin REF_MEASUREMENT components.Simulation.RandomGenerator_instance.seed components.Simulation.RandomGenerator_instance.x /end REF_MEASUREMENT
/end GROUP
/begin GROUP components.Driver ""
 /begin REF_CHARACTERISTIC components.Driver.base_v components.Driver.base_noiselevel components.Driver.deflate_fr components.Driver.deflate_fl components.Driver.deflate_vrl components.Driver.deflate_vrr /end REF_CHARACTERISTIC
 /begin REF_MEASUREMENT components.Driver.rand /end REF_MEASUREMENT
 /begin SUB_GROUP components.Driver.RandomGenerator_instance components.Driver.RandomGenerator_instance_2 components.Driver.RandomGenerator_instance_3 components.Driver.RandomGenerator_instance_4 components.Driver.CalcDiviation_instance components.Driver.CalcDiviation_instance_2 components.Driver.CalcDiviation_instance_3 components.Driver.CalcDiviation_instance_4 /end SUB_GROUP
/end GROUP
/begin GROUP components.Driver.RandomGenerator_instance ""
 /begin REF_CHARACTERISTIC components.Driver.RandomGenerator_instance.a components.Driver.RandomGenerator_instance.m components.Driver.RandomGenerator_instance.c /end REF_CHARACTERISTIC
 /begin REF_MEASUREMENT components.Driver.RandomGenerator_instance.seed components.Driver.RandomGenerator_instance.x /end REF_MEASUREMENT
/end GROUP
/begin GROUP components.Driver.RandomGenerator_instance_2 ""
 /begin REF_CHARACTERISTIC components.Driver.RandomGenerator_instance_2.a components.Driver.RandomGenerator_instance_2.m components.Driver.RandomGenerator_instance_2.c /end REF_CHARACTERISTIC
 /begin REF_MEASUREMENT components.Driver.RandomGenerator_instance_2.seed components.Driver.RandomGenerator_instance_2.x /end REF_MEASUREMENT
/end GROUP
/begin GROUP components.Driver.RandomGenerator_instance_3 ""
 /begin REF_CHARACTERISTIC components.Driver.RandomGenerator_instance_3.a components.Driver.RandomGenerator_instance_3.m components.Driver.RandomGenerator_instance_3.c /end REF_CHARACTERISTIC
 /begin REF_MEASUREMENT components.Driver.RandomGenerator_instance_3.seed components.Driver.RandomGenerator_instance_3.x /end REF_MEASUREMENT
/end GROUP
/begin GROUP components.Driver.RandomGenerator_instance_4 ""
 /begin REF_CHARACTERISTIC components.Driver.RandomGenerator_instance_4.a components.Driver.RandomGenerator_instance_4.m components.Driver.RandomGenerator_instance_4.c /end REF_CHARACTERISTIC
 /begin REF_MEASUREMENT components.Driver.RandomGenerator_instance_4.seed components.Driver.RandomGenerator_instance_4.x /end REF_MEASUREMENT
/end GROUP
/begin GROUP components.Driver.CalcDiviation_instance "" /end GROUP
/begin GROUP components.Driver.CalcDiviation_instance_2 "" /end GROUP
/begin GROUP components.Driver.CalcDiviation_instance_3 "" /end GROUP
/begin GROUP components.Driver.CalcDiviation_instance_4 "" /end GROUP
/begin GROUP components.TirePressureMonitoring ""
 /begin REF_MEASUREMENT components.TirePressureMonitoring.diff_sfl components.TirePressureMonitoring.diff_sfr components.TirePressureMonitoring.diff_srl components.TirePressureMonitoring.diff_srr components.TirePressureMonitoring.fl_failure components.TirePressureMonitoring.fr_failure components.TirePressureMonitoring.mean_exFl components.TirePressureMonitoring.mean_exFr components.TirePressureMonitoring.mean_exRl components.TirePressureMonitoring.mean_exRr components.TirePressureMonitoring.rl_failure components.TirePressureMonitoring.rr_failure /end REF_MEASUREMENT
 /begin SUB_GROUP components.TirePressureMonitoring.TireDeviation_instance components.TirePressureMonitoring.TireDeviation_instance_2 components.TirePressureMonitoring.TireDeviation_instance_3 components.TirePressureMonitoring.TireDeviation_instance_4 components.TirePressureMonitoring.TireMean_instance components.TirePressureMonitoring.TireMean_instance_2 components.TirePressureMonitoring.TireMean_instance_3 components.TirePressureMonitoring.TireMean_instance_4 /end SUB_GROUP
/end GROUP
/begin GROUP components.TirePressureMonitoring.TireDeviation_instance ""
 /begin REF_MEASUREMENT components.TirePressureMonitoring.TireDeviation_instance.diff components.TirePressureMonitoring.TireDeviation_instance.limit components.TirePressureMonitoring.TireDeviation_instance.mean components.TirePressureMonitoring.TireDeviation_instance.v /end REF_MEASUREMENT
/end GROUP
/begin GROUP components.TirePressureMonitoring.TireDeviation_instance_2 ""
 /begin REF_MEASUREMENT components.TirePressureMonitoring.TireDeviation_instance_2.diff components.TirePressureMonitoring.TireDeviation_instance_2.limit components.TirePressureMonitoring.TireDeviation_instance_2.mean components.TirePressureMonitoring.TireDeviation_instance_2.v /end REF_MEASUREMENT
/end GROUP
/begin GROUP components.TirePressureMonitoring.TireDeviation_instance_3 ""
 /begin REF_MEASUREMENT components.TirePressureMonitoring.TireDeviation_instance_3.diff components.TirePressureMonitoring.TireDeviation_instance_3.limit components.TirePressureMonitoring.TireDeviation_instance_3.mean components.TirePressureMonitoring.TireDeviation_instance_3.v /end REF_MEASUREMENT
/end GROUP
/begin GROUP components.TirePressureMonitoring.TireDeviation_instance_4 ""
 /begin REF_MEASUREMENT components.TirePressureMonitoring.TireDeviation_instance_4.diff components.TirePressureMonitoring.TireDeviation_instance_4.limit components.TirePressureMonitoring.TireDeviation_instance_4.mean components.TirePressureMonitoring.TireDeviation_instance_4.v /end REF_MEASUREMENT
/end GROUP
/begin GROUP components.TirePressureMonitoring.TireMean_instance "" /end GROUP
/begin GROUP components.TirePressureMonitoring.TireMean_instance_2 "" /end GROUP
/begin GROUP components.TirePressureMonitoring.TireMean_instance_3 "" /end GROUP
/begin GROUP components.TirePressureMonitoring.TireMean_instance_4 "" /end GROUP
/end MODULE
/end PROJECT
