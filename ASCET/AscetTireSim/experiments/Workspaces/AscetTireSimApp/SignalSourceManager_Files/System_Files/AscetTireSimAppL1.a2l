ASAP2_VERSION 1 41
/begin PROJECT AscetTireSimApp "Generated by ETAS from Project AscetTireSimApp"
/begin HEADER "" VERSION "000" PROJECT_NO ASD /end HEADER
/begin MODULE AscetTireSimApp "Generated by ETAS ASCET7 from Project: AscetTireSimApp"
/begin IF_DATA E_TARGET
 /begin SOURCE "Task0" 3 /* period */ 10 QP_BLOB 1 /end SOURCE
 /begin TP_BLOB /* programm id */ 3439342328 /* target id */ 7 0 2 0 /end TP_BLOB
/end IF_DATA
/begin MOD_PAR "" VERSION "000" ADDR_EPK 0x0 EPK "" SUPPLIER "ETAS GmbH" CUSTOMER "xxx" CUSTOMER_NO "000" USER "xxx" PHONE_NO "000" ECU "PC" CPU_TYPE "PCx86" NO_OF_INTERFACES 1 /end MOD_PAR
/begin MOD_COMMON "Common definitions" BYTE_ORDER MSB_LAST ALIGNMENT_BYTE 1 ALIGNMENT_WORD 2 ALIGNMENT_LONG 4 ALIGNMENT_FLOAT32_IEEE 4 ALIGNMENT_FLOAT64_IEEE 8 /end MOD_COMMON
/begin CHARACTERISTIC runnableModels.sim_statemachine.failure "" VALUE 0x4580E0 STANDARD_VALUE_U8 0.0 esdl_ident 0 1 BIT_MASK 0x1 /end CHARACTERISTIC
/begin CHARACTERISTIC runnableModels.Simulation.status_tire "" VALUE 0x436308 STANDARD_VALUE_U8 0.0 esdl_ident 0 1 BIT_MASK 0x1 /end CHARACTERISTIC
/begin CHARACTERISTIC runnableModels.Simulation.base_v "" VALUE 0x436304 STANDARD_VALUE_R32 0.0 esdl_ident -3.4028234663852886E+38 3.4028234663852886E+38 /end CHARACTERISTIC
/begin CHARACTERISTIC runnableModels.Simulation.base_noiselevel "" VALUE 0x436300 STANDARD_VALUE_R32 0.0 esdl_ident -3.4028234663852886E+38 3.4028234663852886E+38 /end CHARACTERISTIC
/begin CHARACTERISTIC runnableModels.Simulation.RandomGenerator_instance.a "" VALUE 0x43630A STANDARD_VALUE_U16 0.0 esdl_ident 0 1024 /end CHARACTERISTIC
/begin CHARACTERISTIC runnableModels.Simulation.RandomGenerator_instance.m "" VALUE 0x43630E STANDARD_VALUE_U16 0.0 esdl_ident 0 1024 /end CHARACTERISTIC
/begin CHARACTERISTIC runnableModels.Simulation.RandomGenerator_instance.c "" VALUE 0x43630C STANDARD_VALUE_U16 0.0 esdl_ident 0 1024 /end CHARACTERISTIC
/begin CHARACTERISTIC runnableModels.Driver.base_v "" VALUE 0x4362C4 STANDARD_VALUE_R32 0.0 esdl_ident -3.4028234663852886E+38 3.4028234663852886E+38 /end CHARACTERISTIC
/begin CHARACTERISTIC runnableModels.Driver.base_noiselevel "" VALUE 0x4362C0 STANDARD_VALUE_R32 0.0 esdl_ident -3.4028234663852886E+38 3.4028234663852886E+38 /end CHARACTERISTIC
/begin CHARACTERISTIC runnableModels.Driver.deflate_fr "" VALUE 0x4362D9 STANDARD_VALUE_U8 0.0 esdl_ident 0 1 BIT_MASK 0x1 /end CHARACTERISTIC
/begin CHARACTERISTIC runnableModels.Driver.deflate_fl "" VALUE 0x4362D8 STANDARD_VALUE_U8 0.0 esdl_ident 0 1 BIT_MASK 0x1 /end CHARACTERISTIC
/begin CHARACTERISTIC runnableModels.Driver.deflate_vrl "" VALUE 0x4362DA STANDARD_VALUE_U8 0.0 esdl_ident 0 1 BIT_MASK 0x1 /end CHARACTERISTIC
/begin CHARACTERISTIC runnableModels.Driver.deflate_vrr "" VALUE 0x4362DB STANDARD_VALUE_U8 0.0 esdl_ident 0 1 BIT_MASK 0x1 /end CHARACTERISTIC
/begin CHARACTERISTIC runnableModels.Driver.error_FR "" VALUE 0x4362CC STANDARD_VALUE_R32 0.0 esdl_ident -3.4028234663852886E+38 3.4028234663852886E+38 /end CHARACTERISTIC
/begin CHARACTERISTIC runnableModels.Driver.error_FL "" VALUE 0x4362C8 STANDARD_VALUE_R32 0.0 esdl_ident -3.4028234663852886E+38 3.4028234663852886E+38 /end CHARACTERISTIC
/begin CHARACTERISTIC runnableModels.Driver.error_RL "" VALUE 0x4362D0 STANDARD_VALUE_R32 0.0 esdl_ident -3.4028234663852886E+38 3.4028234663852886E+38 /end CHARACTERISTIC
/begin CHARACTERISTIC runnableModels.Driver.error_RR "" VALUE 0x4362D4 STANDARD_VALUE_R32 0.0 esdl_ident -3.4028234663852886E+38 3.4028234663852886E+38 /end CHARACTERISTIC
/begin CHARACTERISTIC runnableModels.Driver.RandomGenerator_instance.a "" VALUE 0x4362DC STANDARD_VALUE_U16 0.0 esdl_ident 0 1024 /end CHARACTERISTIC
/begin CHARACTERISTIC runnableModels.Driver.RandomGenerator_instance.m "" VALUE 0x4362E0 STANDARD_VALUE_U16 0.0 esdl_ident 0 1024 /end CHARACTERISTIC
/begin CHARACTERISTIC runnableModels.Driver.RandomGenerator_instance.c "" VALUE 0x4362DE STANDARD_VALUE_U16 0.0 esdl_ident 0 1024 /end CHARACTERISTIC
/begin CHARACTERISTIC runnableModels.Driver.RandomGenerator_instance_2.a "" VALUE 0x4362E2 STANDARD_VALUE_U16 0.0 esdl_ident 0 1024 /end CHARACTERISTIC
/begin CHARACTERISTIC runnableModels.Driver.RandomGenerator_instance_2.m "" VALUE 0x4362E6 STANDARD_VALUE_U16 0.0 esdl_ident 0 1024 /end CHARACTERISTIC
/begin CHARACTERISTIC runnableModels.Driver.RandomGenerator_instance_2.c "" VALUE 0x4362E4 STANDARD_VALUE_U16 0.0 esdl_ident 0 1024 /end CHARACTERISTIC
/begin CHARACTERISTIC runnableModels.Driver.RandomGenerator_instance_3.a "" VALUE 0x4362E8 STANDARD_VALUE_U16 0.0 esdl_ident 0 1024 /end CHARACTERISTIC
/begin CHARACTERISTIC runnableModels.Driver.RandomGenerator_instance_3.m "" VALUE 0x4362EC STANDARD_VALUE_U16 0.0 esdl_ident 0 1024 /end CHARACTERISTIC
/begin CHARACTERISTIC runnableModels.Driver.RandomGenerator_instance_3.c "" VALUE 0x4362EA STANDARD_VALUE_U16 0.0 esdl_ident 0 1024 /end CHARACTERISTIC
/begin CHARACTERISTIC runnableModels.Driver.RandomGenerator_instance_4.a "" VALUE 0x4362EE STANDARD_VALUE_U16 0.0 esdl_ident 0 1024 /end CHARACTERISTIC
/begin CHARACTERISTIC runnableModels.Driver.RandomGenerator_instance_4.m "" VALUE 0x4362F2 STANDARD_VALUE_U16 0.0 esdl_ident 0 1024 /end CHARACTERISTIC
/begin CHARACTERISTIC runnableModels.Driver.RandomGenerator_instance_4.c "" VALUE 0x4362F0 STANDARD_VALUE_U16 0.0 esdl_ident 0 1024 /end CHARACTERISTIC
/begin CHARACTERISTIC runnableModels.ResetFunctionality.ResetButton "" VALUE 0x454180 STANDARD_VALUE_U8 0.0 esdl_ident 0 1 BIT_MASK 0x1 /end CHARACTERISTIC
/begin MEASUREMENT runnableModels.sim_statemachine.SOS_state_instance.sm "" UBYTE esdl_components_SOS_stateStatemachineStates 1 100.0 0 4 ECU_ADDRESS 0x4580DD /end MEASUREMENT
/begin MEASUREMENT runnableModels.sim_statemachine.SOS_state_instance.x "" SLONG esdl_ident 1 100.0 -2147483648 2147483647 ECU_ADDRESS 0x4580D4 /end MEASUREMENT
/begin MEASUREMENT runnableModels.sim_statemachine.SOS_state_instance.status "" SLONG esdl_ident 1 100.0 -2147483648 2147483647 ECU_ADDRESS 0x4580D0 /end MEASUREMENT
/begin MEASUREMENT runnableModels.sim_statemachine.SOS_state_instance.myDT "" FLOAT32_IEEE esdl_ident 1 100.0 -3.4028234663852886E+38 3.4028234663852886E+38 ECU_ADDRESS 0x4580C4 /end MEASUREMENT
/begin MEASUREMENT runnableModels.sim_statemachine.SOS_state_instance.duration "" FLOAT32_IEEE esdl_ident 1 100.0 -3.4028234663852886E+38 3.4028234663852886E+38 ECU_ADDRESS 0x4580C0 /end MEASUREMENT
/begin MEASUREMENT runnableModels.sim_statemachine.SOS_state_instance.y "" SLONG esdl_ident 1 100.0 -2147483648 2147483647 ECU_ADDRESS 0x4580D8 /end MEASUREMENT
/begin MEASUREMENT runnableModels.sim_statemachine.SOS_state_instance.run "" SLONG esdl_ident 1 100.0 -2147483648 2147483647 ECU_ADDRESS 0x4580C8 /end MEASUREMENT
/begin MEASUREMENT runnableModels.sim_statemachine.SOS_state_instance.aktiv "" UBYTE esdl_ident 1 100.0 0 1 ECU_ADDRESS 0x4580DC BIT_MASK 0x1 /end MEASUREMENT
/begin MEASUREMENT runnableModels.sim_statemachine.SOS_state_instance.statelocation "" FLOAT32_IEEE esdl_ident 1 100.0 -3.4028234663852886E+38 3.4028234663852886E+38 ECU_ADDRESS 0x4580CC /end MEASUREMENT
/begin MEASUREMENT interfaces.interfaces.failure_detected "" UBYTE esdl_ident 1 100.0 0 1 ECU_ADDRESS 0x4540E9 BIT_MASK 0x1 /end MEASUREMENT
/begin MEASUREMENT interfaces.interfaces.vfr "" FLOAT32_IEEE esdl_ident 1 100.0 -3.4028234663852886E+38 3.4028234663852886E+38 ECU_ADDRESS 0x4540F4 /end MEASUREMENT
/begin MEASUREMENT interfaces.interfaces.vfl "" FLOAT32_IEEE esdl_ident 1 100.0 -3.4028234663852886E+38 3.4028234663852886E+38 ECU_ADDRESS 0x4540F8 /end MEASUREMENT
/begin MEASUREMENT interfaces.interfaces.vrl "" FLOAT32_IEEE esdl_ident 1 100.0 -3.4028234663852886E+38 3.4028234663852886E+38 ECU_ADDRESS 0x4540F0 /end MEASUREMENT
/begin MEASUREMENT interfaces.interfaces.vrr "" FLOAT32_IEEE esdl_ident 1 100.0 -3.4028234663852886E+38 3.4028234663852886E+38 ECU_ADDRESS 0x4540EC /end MEASUREMENT
/begin MEASUREMENT interfaces.interfaces.delta_sfr "" FLOAT32_IEEE esdl_ident 1 100.0 -3.4028234663852886E+38 3.4028234663852886E+38 ECU_ADDRESS 0x454118 /end MEASUREMENT
/begin MEASUREMENT interfaces.interfaces.delta_sfl "" FLOAT32_IEEE esdl_ident 1 100.0 -3.4028234663852886E+38 3.4028234663852886E+38 ECU_ADDRESS 0x45411C /end MEASUREMENT
/begin MEASUREMENT interfaces.interfaces.delta_srr "" FLOAT32_IEEE esdl_ident 1 100.0 -3.4028234663852886E+38 3.4028234663852886E+38 ECU_ADDRESS 0x454110 /end MEASUREMENT
/begin MEASUREMENT interfaces.interfaces.delta_srl "" FLOAT32_IEEE esdl_ident 1 100.0 -3.4028234663852886E+38 3.4028234663852886E+38 ECU_ADDRESS 0x454114 /end MEASUREMENT
/begin MEASUREMENT interfaces.interfaces.sfr "" FLOAT32_IEEE esdl_ident 1 100.0 -3.4028234663852886E+38 3.4028234663852886E+38 ECU_ADDRESS 0x454104 /end MEASUREMENT
/begin MEASUREMENT interfaces.interfaces.sfl "" FLOAT32_IEEE esdl_ident 1 100.0 -3.4028234663852886E+38 3.4028234663852886E+38 ECU_ADDRESS 0x454108 /end MEASUREMENT
/begin MEASUREMENT interfaces.interfaces.srl "" FLOAT32_IEEE esdl_ident 1 100.0 -3.4028234663852886E+38 3.4028234663852886E+38 ECU_ADDRESS 0x454100 /end MEASUREMENT
/begin MEASUREMENT interfaces.interfaces.srr "" FLOAT32_IEEE esdl_ident 1 100.0 -3.4028234663852886E+38 3.4028234663852886E+38 ECU_ADDRESS 0x4540FC /end MEASUREMENT
/begin MEASUREMENT interfaces.interfaces.noFailure "" UBYTE esdl_ident 1 100.0 0 1 ECU_ADDRESS 0x4540E8 BIT_MASK 0x1 /end MEASUREMENT
/begin MEASUREMENT interfaces.interfaces.mean "" FLOAT32_IEEE esdl_ident 1 100.0 -3.4028234663852886E+38 3.4028234663852886E+38 ECU_ADDRESS 0x45410C /end MEASUREMENT
/begin MEASUREMENT components.Globals.limit "" FLOAT32_IEEE esdl_ident 1 100.0 -3.4028234663852886E+38 3.4028234663852886E+38 ECU_ADDRESS 0x436320 /end MEASUREMENT
/begin MEASUREMENT components.Globals.limit_RR "" FLOAT32_IEEE esdl_ident 1 100.0 -3.4028234663852886E+38 3.4028234663852886E+38 ECU_ADDRESS 0x436310 /end MEASUREMENT
/begin MEASUREMENT components.Globals.limit_RL "" FLOAT32_IEEE esdl_ident 1 100.0 -3.4028234663852886E+38 3.4028234663852886E+38 ECU_ADDRESS 0x436314 /end MEASUREMENT
/begin MEASUREMENT components.Globals.limit_FR "" FLOAT32_IEEE esdl_ident 1 100.0 -3.4028234663852886E+38 3.4028234663852886E+38 ECU_ADDRESS 0x436318 /end MEASUREMENT
/begin MEASUREMENT components.Globals.limit_FL "" FLOAT32_IEEE esdl_ident 1 100.0 -3.4028234663852886E+38 3.4028234663852886E+38 ECU_ADDRESS 0x43631C /end MEASUREMENT
/begin MEASUREMENT runnableModels.Simulation.sfl "" FLOAT32_IEEE esdl_ident 1 100.0 -3.4028234663852886E+38 3.4028234663852886E+38 ECU_ADDRESS 0x4541B8 /end MEASUREMENT
/begin MEASUREMENT runnableModels.Simulation.srl "" FLOAT32_IEEE esdl_ident 1 100.0 -3.4028234663852886E+38 3.4028234663852886E+38 ECU_ADDRESS 0x4541C0 /end MEASUREMENT
/begin MEASUREMENT runnableModels.Simulation.srr "" FLOAT32_IEEE esdl_ident 1 100.0 -3.4028234663852886E+38 3.4028234663852886E+38 ECU_ADDRESS 0x4541C4 /end MEASUREMENT
/begin MEASUREMENT runnableModels.Simulation.sfr "" FLOAT32_IEEE esdl_ident 1 100.0 -3.4028234663852886E+38 3.4028234663852886E+38 ECU_ADDRESS 0x4541BC /end MEASUREMENT
/begin MEASUREMENT runnableModels.Simulation.rand "" FLOAT32_IEEE esdl_ident 1 100.0 -3.4028234663852886E+38 3.4028234663852886E+38 ECU_ADDRESS 0x4541B4 /end MEASUREMENT
/begin MEASUREMENT runnableModels.Simulation.diff_sfl "" FLOAT32_IEEE esdl_ident 1 100.0 -3.4028234663852886E+38 3.4028234663852886E+38 ECU_ADDRESS 0x4541A0 /end MEASUREMENT
/begin MEASUREMENT runnableModels.Simulation.diff_sfr "" FLOAT32_IEEE esdl_ident 1 100.0 -3.4028234663852886E+38 3.4028234663852886E+38 ECU_ADDRESS 0x4541A4 /end MEASUREMENT
/begin MEASUREMENT runnableModels.Simulation.diff_srr "" FLOAT32_IEEE esdl_ident 1 100.0 -3.4028234663852886E+38 3.4028234663852886E+38 ECU_ADDRESS 0x4541AC /end MEASUREMENT
/begin MEASUREMENT runnableModels.Simulation.diff_srl "" FLOAT32_IEEE esdl_ident 1 100.0 -3.4028234663852886E+38 3.4028234663852886E+38 ECU_ADDRESS 0x4541A8 /end MEASUREMENT
/begin MEASUREMENT runnableModels.Simulation.mean "" FLOAT32_IEEE esdl_ident 1 100.0 -3.4028234663852886E+38 3.4028234663852886E+38 ECU_ADDRESS 0x4541B0 /end MEASUREMENT
/begin MEASUREMENT runnableModels.Simulation.fl_failure "" UBYTE esdl_ident 1 100.0 0 1 ECU_ADDRESS 0x4541D8 BIT_MASK 0x1 /end MEASUREMENT
/begin MEASUREMENT runnableModels.Simulation.fr_failure "" UBYTE esdl_ident 1 100.0 0 1 ECU_ADDRESS 0x4541D9 BIT_MASK 0x1 /end MEASUREMENT
/begin MEASUREMENT runnableModels.Simulation.rl_failure "" UBYTE esdl_ident 1 100.0 0 1 ECU_ADDRESS 0x4541DA BIT_MASK 0x1 /end MEASUREMENT
/begin MEASUREMENT runnableModels.Simulation.rr_failure "" UBYTE esdl_ident 1 100.0 0 1 ECU_ADDRESS 0x4541DB BIT_MASK 0x1 /end MEASUREMENT
/begin MEASUREMENT runnableModels.Simulation.vfr "" FLOAT32_IEEE esdl_ident 1 100.0 -3.4028234663852886E+38 3.4028234663852886E+38 ECU_ADDRESS 0x4541CC /end MEASUREMENT
/begin MEASUREMENT runnableModels.Simulation.vrr "" FLOAT32_IEEE esdl_ident 1 100.0 -3.4028234663852886E+38 3.4028234663852886E+38 ECU_ADDRESS 0x4541D4 /end MEASUREMENT
/begin MEASUREMENT runnableModels.Simulation.vfl "" FLOAT32_IEEE esdl_ident 1 100.0 -3.4028234663852886E+38 3.4028234663852886E+38 ECU_ADDRESS 0x4541C8 /end MEASUREMENT
/begin MEASUREMENT runnableModels.Simulation.vrl "" FLOAT32_IEEE esdl_ident 1 100.0 -3.4028234663852886E+38 3.4028234663852886E+38 ECU_ADDRESS 0x4541D0 /end MEASUREMENT
/begin MEASUREMENT runnableModels.Simulation.Model_instance.sfl "" FLOAT32_IEEE esdl_ident 1 100.0 -3.4028234663852886E+38 3.4028234663852886E+38 ECU_ADDRESS 0x4541EC /end MEASUREMENT
/begin MEASUREMENT runnableModels.Simulation.Model_instance.sfr "" FLOAT32_IEEE esdl_ident 1 100.0 -3.4028234663852886E+38 3.4028234663852886E+38 ECU_ADDRESS 0x4541F4 /end MEASUREMENT
/begin MEASUREMENT runnableModels.Simulation.Model_instance.srl "" FLOAT32_IEEE esdl_ident 1 100.0 -3.4028234663852886E+38 3.4028234663852886E+38 ECU_ADDRESS 0x4541FC /end MEASUREMENT
/begin MEASUREMENT runnableModels.Simulation.Model_instance.srr "" FLOAT32_IEEE esdl_ident 1 100.0 -3.4028234663852886E+38 3.4028234663852886E+38 ECU_ADDRESS 0x454204 /end MEASUREMENT
/begin MEASUREMENT runnableModels.Simulation.Model_instance.sfl_before "" FLOAT32_IEEE esdl_ident 1 100.0 -3.4028234663852886E+38 3.4028234663852886E+38 ECU_ADDRESS 0x4541F0 /end MEASUREMENT
/begin MEASUREMENT runnableModels.Simulation.Model_instance.sfr_before "" FLOAT32_IEEE esdl_ident 1 100.0 -3.4028234663852886E+38 3.4028234663852886E+38 ECU_ADDRESS 0x4541F8 /end MEASUREMENT
/begin MEASUREMENT runnableModels.Simulation.Model_instance.srl_before "" FLOAT32_IEEE esdl_ident 1 100.0 -3.4028234663852886E+38 3.4028234663852886E+38 ECU_ADDRESS 0x454200 /end MEASUREMENT
/begin MEASUREMENT runnableModels.Simulation.Model_instance.srr_before "" FLOAT32_IEEE esdl_ident 1 100.0 -3.4028234663852886E+38 3.4028234663852886E+38 ECU_ADDRESS 0x454208 /end MEASUREMENT
/begin MEASUREMENT runnableModels.Simulation.Model_instance.delta_sfl "" FLOAT32_IEEE esdl_ident 1 100.0 -3.4028234663852886E+38 3.4028234663852886E+38 ECU_ADDRESS 0x4541DC /end MEASUREMENT
/begin MEASUREMENT runnableModels.Simulation.Model_instance.delta_sfr "" FLOAT32_IEEE esdl_ident 1 100.0 -3.4028234663852886E+38 3.4028234663852886E+38 ECU_ADDRESS 0x4541E0 /end MEASUREMENT
/begin MEASUREMENT runnableModels.Simulation.Model_instance.delta_srl "" FLOAT32_IEEE esdl_ident 1 100.0 -3.4028234663852886E+38 3.4028234663852886E+38 ECU_ADDRESS 0x4541E4 /end MEASUREMENT
/begin MEASUREMENT runnableModels.Simulation.Model_instance.delta_srr "" FLOAT32_IEEE esdl_ident 1 100.0 -3.4028234663852886E+38 3.4028234663852886E+38 ECU_ADDRESS 0x4541E8 /end MEASUREMENT
/begin MEASUREMENT runnableModels.Simulation.Model_instance.RingBuffer_instance.buffer "" FLOAT32_IEEE esdl_ident 1 100.0 -3.4028234663852886E+38 3.4028234663852886E+38 ECU_ADDRESS 0x45420C MATRIX_DIM 1000 1 1 /end MEASUREMENT
/begin MEASUREMENT runnableModels.Simulation.Model_instance.RingBuffer_instance.c "" FLOAT32_IEEE esdl_ident 1 100.0 -3.4028234663852886E+38 3.4028234663852886E+38 ECU_ADDRESS 0x4551AC /end MEASUREMENT
/begin MEASUREMENT runnableModels.Simulation.Model_instance.RingBuffer_instance.swap "" FLOAT32_IEEE esdl_ident 1 100.0 -3.4028234663852886E+38 3.4028234663852886E+38 ECU_ADDRESS 0x4551B0 /end MEASUREMENT
/begin MEASUREMENT runnableModels.Simulation.Model_instance.RingBuffer_instance_2.buffer "" FLOAT32_IEEE esdl_ident 1 100.0 -3.4028234663852886E+38 3.4028234663852886E+38 ECU_ADDRESS 0x4551B4 MATRIX_DIM 1000 1 1 /end MEASUREMENT
/begin MEASUREMENT runnableModels.Simulation.Model_instance.RingBuffer_instance_2.c "" FLOAT32_IEEE esdl_ident 1 100.0 -3.4028234663852886E+38 3.4028234663852886E+38 ECU_ADDRESS 0x456154 /end MEASUREMENT
/begin MEASUREMENT runnableModels.Simulation.Model_instance.RingBuffer_instance_2.swap "" FLOAT32_IEEE esdl_ident 1 100.0 -3.4028234663852886E+38 3.4028234663852886E+38 ECU_ADDRESS 0x456158 /end MEASUREMENT
/begin MEASUREMENT runnableModels.Simulation.Model_instance.RingBuffer_instance_3.buffer "" FLOAT32_IEEE esdl_ident 1 100.0 -3.4028234663852886E+38 3.4028234663852886E+38 ECU_ADDRESS 0x45615C MATRIX_DIM 1000 1 1 /end MEASUREMENT
/begin MEASUREMENT runnableModels.Simulation.Model_instance.RingBuffer_instance_3.c "" FLOAT32_IEEE esdl_ident 1 100.0 -3.4028234663852886E+38 3.4028234663852886E+38 ECU_ADDRESS 0x4570FC /end MEASUREMENT
/begin MEASUREMENT runnableModels.Simulation.Model_instance.RingBuffer_instance_3.swap "" FLOAT32_IEEE esdl_ident 1 100.0 -3.4028234663852886E+38 3.4028234663852886E+38 ECU_ADDRESS 0x457100 /end MEASUREMENT
/begin MEASUREMENT runnableModels.Simulation.Model_instance.RingBuffer_instance_4.buffer "" FLOAT32_IEEE esdl_ident 1 100.0 -3.4028234663852886E+38 3.4028234663852886E+38 ECU_ADDRESS 0x457104 MATRIX_DIM 1000 1 1 /end MEASUREMENT
/begin MEASUREMENT runnableModels.Simulation.Model_instance.RingBuffer_instance_4.c "" FLOAT32_IEEE esdl_ident 1 100.0 -3.4028234663852886E+38 3.4028234663852886E+38 ECU_ADDRESS 0x4580A4 /end MEASUREMENT
/begin MEASUREMENT runnableModels.Simulation.Model_instance.RingBuffer_instance_4.swap "" FLOAT32_IEEE esdl_ident 1 100.0 -3.4028234663852886E+38 3.4028234663852886E+38 ECU_ADDRESS 0x4580A8 /end MEASUREMENT
/begin MEASUREMENT runnableModels.Simulation.TireDeviation_instance.v "" FLOAT32_IEEE esdl_ident 1 100.0 -3.4028234663852886E+38 3.4028234663852886E+38 ECU_ADDRESS 0x4580BC /end MEASUREMENT
/begin MEASUREMENT runnableModels.Simulation.TireDeviation_instance.mean "" FLOAT32_IEEE esdl_ident 1 100.0 -3.4028234663852886E+38 3.4028234663852886E+38 ECU_ADDRESS 0x4580B8 /end MEASUREMENT
/begin MEASUREMENT runnableModels.Simulation.TireDeviation_instance.diff "" FLOAT32_IEEE esdl_ident 1 100.0 -3.4028234663852886E+38 3.4028234663852886E+38 ECU_ADDRESS 0x4580B0 /end MEASUREMENT
/begin MEASUREMENT runnableModels.Simulation.TireDeviation_instance.limit "" FLOAT32_IEEE esdl_ident 1 100.0 -3.4028234663852886E+38 3.4028234663852886E+38 ECU_ADDRESS 0x4580B4 /end MEASUREMENT
/begin MEASUREMENT runnableModels.Simulation.RandomGenerator_instance.seed "" UWORD esdl_ident 1 100.0 0 1024 ECU_ADDRESS 0x4580AC /end MEASUREMENT
/begin MEASUREMENT runnableModels.Simulation.RandomGenerator_instance.x "" UWORD esdl_ident 1 100.0 0 1024 ECU_ADDRESS 0x4580AE /end MEASUREMENT
/begin MEASUREMENT runnableModels.Driver.rand "" FLOAT32_IEEE esdl_ident 1 100.0 -3.4028234663852886E+38 3.4028234663852886E+38 ECU_ADDRESS 0x454184 /end MEASUREMENT
/begin MEASUREMENT runnableModels.Driver.RandomGenerator_instance.seed "" UWORD esdl_ident 1 100.0 0 1024 ECU_ADDRESS 0x454188 /end MEASUREMENT
/begin MEASUREMENT runnableModels.Driver.RandomGenerator_instance.x "" UWORD esdl_ident 1 100.0 0 1024 ECU_ADDRESS 0x45418A /end MEASUREMENT
/begin MEASUREMENT runnableModels.Driver.RandomGenerator_instance_2.seed "" UWORD esdl_ident 1 100.0 0 1024 ECU_ADDRESS 0x45418C /end MEASUREMENT
/begin MEASUREMENT runnableModels.Driver.RandomGenerator_instance_2.x "" UWORD esdl_ident 1 100.0 0 1024 ECU_ADDRESS 0x45418E /end MEASUREMENT
/begin MEASUREMENT runnableModels.Driver.RandomGenerator_instance_3.seed "" UWORD esdl_ident 1 100.0 0 1024 ECU_ADDRESS 0x454190 /end MEASUREMENT
/begin MEASUREMENT runnableModels.Driver.RandomGenerator_instance_3.x "" UWORD esdl_ident 1 100.0 0 1024 ECU_ADDRESS 0x454192 /end MEASUREMENT
/begin MEASUREMENT runnableModels.Driver.RandomGenerator_instance_4.seed "" UWORD esdl_ident 1 100.0 0 1024 ECU_ADDRESS 0x454194 /end MEASUREMENT
/begin MEASUREMENT runnableModels.Driver.RandomGenerator_instance_4.x "" UWORD esdl_ident 1 100.0 0 1024 ECU_ADDRESS 0x454196 /end MEASUREMENT
/begin MEASUREMENT runnableModels.TirePressureMonitoring.fr_failure "" UBYTE esdl_ident 1 100.0 0 1 ECU_ADDRESS 0x454135 BIT_MASK 0x1 /end MEASUREMENT
/begin MEASUREMENT runnableModels.TirePressureMonitoring.diff_sfr "" FLOAT32_IEEE esdl_ident 1 100.0 -3.4028234663852886E+38 3.4028234663852886E+38 ECU_ADDRESS 0x454124 /end MEASUREMENT
/begin MEASUREMENT runnableModels.TirePressureMonitoring.diff_sfl "" FLOAT32_IEEE esdl_ident 1 100.0 -3.4028234663852886E+38 3.4028234663852886E+38 ECU_ADDRESS 0x454120 /end MEASUREMENT
/begin MEASUREMENT runnableModels.TirePressureMonitoring.diff_srl "" FLOAT32_IEEE esdl_ident 1 100.0 -3.4028234663852886E+38 3.4028234663852886E+38 ECU_ADDRESS 0x454128 /end MEASUREMENT
/begin MEASUREMENT runnableModels.TirePressureMonitoring.rr_failure "" UBYTE esdl_ident 1 100.0 0 1 ECU_ADDRESS 0x454137 BIT_MASK 0x1 /end MEASUREMENT
/begin MEASUREMENT runnableModels.TirePressureMonitoring.rl_failure "" UBYTE esdl_ident 1 100.0 0 1 ECU_ADDRESS 0x454136 BIT_MASK 0x1 /end MEASUREMENT
/begin MEASUREMENT runnableModels.TirePressureMonitoring.diff_srr "" FLOAT32_IEEE esdl_ident 1 100.0 -3.4028234663852886E+38 3.4028234663852886E+38 ECU_ADDRESS 0x45412C /end MEASUREMENT
/begin MEASUREMENT runnableModels.TirePressureMonitoring.fl_failure "" UBYTE esdl_ident 1 100.0 0 1 ECU_ADDRESS 0x454134 BIT_MASK 0x1 /end MEASUREMENT
/begin MEASUREMENT runnableModels.TirePressureMonitoring.mean "" FLOAT32_IEEE esdl_ident 1 100.0 -3.4028234663852886E+38 3.4028234663852886E+38 ECU_ADDRESS 0x454130 /end MEASUREMENT
/begin MEASUREMENT runnableModels.TirePressureMonitoring.test "" UBYTE esdl_ident 1 100.0 0 1 ECU_ADDRESS 0x454138 BIT_MASK 0x1 /end MEASUREMENT
/begin MEASUREMENT runnableModels.TirePressureMonitoring.TireDeviation_instance.v "" FLOAT32_IEEE esdl_ident 1 100.0 -3.4028234663852886E+38 3.4028234663852886E+38 ECU_ADDRESS 0x454148 /end MEASUREMENT
/begin MEASUREMENT runnableModels.TirePressureMonitoring.TireDeviation_instance.mean "" FLOAT32_IEEE esdl_ident 1 100.0 -3.4028234663852886E+38 3.4028234663852886E+38 ECU_ADDRESS 0x454144 /end MEASUREMENT
/begin MEASUREMENT runnableModels.TirePressureMonitoring.TireDeviation_instance.diff "" FLOAT32_IEEE esdl_ident 1 100.0 -3.4028234663852886E+38 3.4028234663852886E+38 ECU_ADDRESS 0x45413C /end MEASUREMENT
/begin MEASUREMENT runnableModels.TirePressureMonitoring.TireDeviation_instance.limit "" FLOAT32_IEEE esdl_ident 1 100.0 -3.4028234663852886E+38 3.4028234663852886E+38 ECU_ADDRESS 0x454140 /end MEASUREMENT
/begin MEASUREMENT runnableModels.TirePressureMonitoring.TireDeviation_instance_2.v "" FLOAT32_IEEE esdl_ident 1 100.0 -3.4028234663852886E+38 3.4028234663852886E+38 ECU_ADDRESS 0x454158 /end MEASUREMENT
/begin MEASUREMENT runnableModels.TirePressureMonitoring.TireDeviation_instance_2.mean "" FLOAT32_IEEE esdl_ident 1 100.0 -3.4028234663852886E+38 3.4028234663852886E+38 ECU_ADDRESS 0x454154 /end MEASUREMENT
/begin MEASUREMENT runnableModels.TirePressureMonitoring.TireDeviation_instance_2.diff "" FLOAT32_IEEE esdl_ident 1 100.0 -3.4028234663852886E+38 3.4028234663852886E+38 ECU_ADDRESS 0x45414C /end MEASUREMENT
/begin MEASUREMENT runnableModels.TirePressureMonitoring.TireDeviation_instance_2.limit "" FLOAT32_IEEE esdl_ident 1 100.0 -3.4028234663852886E+38 3.4028234663852886E+38 ECU_ADDRESS 0x454150 /end MEASUREMENT
/begin MEASUREMENT runnableModels.TirePressureMonitoring.TireDeviation_instance_3.v "" FLOAT32_IEEE esdl_ident 1 100.0 -3.4028234663852886E+38 3.4028234663852886E+38 ECU_ADDRESS 0x454168 /end MEASUREMENT
/begin MEASUREMENT runnableModels.TirePressureMonitoring.TireDeviation_instance_3.mean "" FLOAT32_IEEE esdl_ident 1 100.0 -3.4028234663852886E+38 3.4028234663852886E+38 ECU_ADDRESS 0x454164 /end MEASUREMENT
/begin MEASUREMENT runnableModels.TirePressureMonitoring.TireDeviation_instance_3.diff "" FLOAT32_IEEE esdl_ident 1 100.0 -3.4028234663852886E+38 3.4028234663852886E+38 ECU_ADDRESS 0x45415C /end MEASUREMENT
/begin MEASUREMENT runnableModels.TirePressureMonitoring.TireDeviation_instance_3.limit "" FLOAT32_IEEE esdl_ident 1 100.0 -3.4028234663852886E+38 3.4028234663852886E+38 ECU_ADDRESS 0x454160 /end MEASUREMENT
/begin MEASUREMENT runnableModels.TirePressureMonitoring.TireDeviation_instance_4.v "" FLOAT32_IEEE esdl_ident 1 100.0 -3.4028234663852886E+38 3.4028234663852886E+38 ECU_ADDRESS 0x454178 /end MEASUREMENT
/begin MEASUREMENT runnableModels.TirePressureMonitoring.TireDeviation_instance_4.mean "" FLOAT32_IEEE esdl_ident 1 100.0 -3.4028234663852886E+38 3.4028234663852886E+38 ECU_ADDRESS 0x454174 /end MEASUREMENT
/begin MEASUREMENT runnableModels.TirePressureMonitoring.TireDeviation_instance_4.diff "" FLOAT32_IEEE esdl_ident 1 100.0 -3.4028234663852886E+38 3.4028234663852886E+38 ECU_ADDRESS 0x45416C /end MEASUREMENT
/begin MEASUREMENT runnableModels.TirePressureMonitoring.TireDeviation_instance_4.limit "" FLOAT32_IEEE esdl_ident 1 100.0 -3.4028234663852886E+38 3.4028234663852886E+38 ECU_ADDRESS 0x454170 /end MEASUREMENT
/begin MEASUREMENT runnableModels.ResetFunctionality.restValid "" UBYTE esdl_ident 1 100.0 0 1 ECU_ADDRESS 0x436221 BIT_MASK 0x1 /end MEASUREMENT
/begin MEASUREMENT runnableModels.ResetFunctionality.exitState "" UBYTE esdl_ident 1 100.0 0 1 ECU_ADDRESS 0x436220 BIT_MASK 0x1 /end MEASUREMENT
/begin MEASUREMENT runnableModels.ResetFunctionality.test "" UBYTE esdl_ident 1 100.0 0 1 ECU_ADDRESS 0x436222 BIT_MASK 0x1 /end MEASUREMENT
/begin MEASUREMENT runnableModels.ResetFunctionality.ResetStateMachine_instance.sm "" UBYTE esdl_runnableModels_ResetStateMachineStatemachineStates 1 100.0 0 3 ECU_ADDRESS 0x436243 /end MEASUREMENT
/begin MEASUREMENT runnableModels.ResetFunctionality.ResetStateMachine_instance.reset "" UBYTE esdl_ident 1 100.0 0 1 ECU_ADDRESS 0x436241 BIT_MASK 0x1 /end MEASUREMENT
/begin MEASUREMENT runnableModels.ResetFunctionality.ResetStateMachine_instance.myDT "" FLOAT32_IEEE esdl_ident 1 100.0 -3.4028234663852886E+38 3.4028234663852886E+38 ECU_ADDRESS 0x436238 /end MEASUREMENT
/begin MEASUREMENT runnableModels.ResetFunctionality.ResetStateMachine_instance.delta_xx "" FLOAT32_IEEE esdl_ident 1 100.0 -3.4028234663852886E+38 3.4028234663852886E+38 ECU_ADDRESS 0x436224 /end MEASUREMENT
/begin MEASUREMENT runnableModels.ResetFunctionality.ResetStateMachine_instance.mean "" FLOAT32_IEEE esdl_ident 1 100.0 -3.4028234663852886E+38 3.4028234663852886E+38 ECU_ADDRESS 0x436234 /end MEASUREMENT
/begin MEASUREMENT runnableModels.ResetFunctionality.ResetStateMachine_instance.new_limit "" FLOAT32_IEEE esdl_ident 1 100.0 -3.4028234663852886E+38 3.4028234663852886E+38 ECU_ADDRESS 0x43623C /end MEASUREMENT
/begin MEASUREMENT runnableModels.ResetFunctionality.ResetStateMachine_instance.duration "" FLOAT32_IEEE esdl_ident 1 100.0 -3.4028234663852886E+38 3.4028234663852886E+38 ECU_ADDRESS 0x43622C /end MEASUREMENT
/begin MEASUREMENT runnableModels.ResetFunctionality.ResetStateMachine_instance.diff_xx "" FLOAT32_IEEE esdl_ident 1 100.0 -3.4028234663852886E+38 3.4028234663852886E+38 ECU_ADDRESS 0x436228 /end MEASUREMENT
/begin MEASUREMENT runnableModels.ResetFunctionality.ResetStateMachine_instance.limit "" FLOAT32_IEEE esdl_ident 1 100.0 -3.4028234663852886E+38 3.4028234663852886E+38 ECU_ADDRESS 0x436230 /end MEASUREMENT
/begin MEASUREMENT runnableModels.ResetFunctionality.ResetStateMachine_instance.setDone "" UBYTE esdl_ident 1 100.0 0 1 ECU_ADDRESS 0x436242 BIT_MASK 0x1 /end MEASUREMENT
/begin MEASUREMENT runnableModels.ResetFunctionality.ResetStateMachine_instance.noFailure "" UBYTE esdl_ident 1 100.0 0 1 ECU_ADDRESS 0x436240 BIT_MASK 0x1 /end MEASUREMENT
/begin MEASUREMENT runnableModels.ResetFunctionality.ResetStateMachine_instance_2.sm "" UBYTE esdl_runnableModels_ResetStateMachineStatemachineStates 1 100.0 0 3 ECU_ADDRESS 0x436263 /end MEASUREMENT
/begin MEASUREMENT runnableModels.ResetFunctionality.ResetStateMachine_instance_2.reset "" UBYTE esdl_ident 1 100.0 0 1 ECU_ADDRESS 0x436261 BIT_MASK 0x1 /end MEASUREMENT
/begin MEASUREMENT runnableModels.ResetFunctionality.ResetStateMachine_instance_2.myDT "" FLOAT32_IEEE esdl_ident 1 100.0 -3.4028234663852886E+38 3.4028234663852886E+38 ECU_ADDRESS 0x436258 /end MEASUREMENT
/begin MEASUREMENT runnableModels.ResetFunctionality.ResetStateMachine_instance_2.delta_xx "" FLOAT32_IEEE esdl_ident 1 100.0 -3.4028234663852886E+38 3.4028234663852886E+38 ECU_ADDRESS 0x436244 /end MEASUREMENT
/begin MEASUREMENT runnableModels.ResetFunctionality.ResetStateMachine_instance_2.mean "" FLOAT32_IEEE esdl_ident 1 100.0 -3.4028234663852886E+38 3.4028234663852886E+38 ECU_ADDRESS 0x436254 /end MEASUREMENT
/begin MEASUREMENT runnableModels.ResetFunctionality.ResetStateMachine_instance_2.new_limit "" FLOAT32_IEEE esdl_ident 1 100.0 -3.4028234663852886E+38 3.4028234663852886E+38 ECU_ADDRESS 0x43625C /end MEASUREMENT
/begin MEASUREMENT runnableModels.ResetFunctionality.ResetStateMachine_instance_2.duration "" FLOAT32_IEEE esdl_ident 1 100.0 -3.4028234663852886E+38 3.4028234663852886E+38 ECU_ADDRESS 0x43624C /end MEASUREMENT
/begin MEASUREMENT runnableModels.ResetFunctionality.ResetStateMachine_instance_2.diff_xx "" FLOAT32_IEEE esdl_ident 1 100.0 -3.4028234663852886E+38 3.4028234663852886E+38 ECU_ADDRESS 0x436248 /end MEASUREMENT
/begin MEASUREMENT runnableModels.ResetFunctionality.ResetStateMachine_instance_2.limit "" FLOAT32_IEEE esdl_ident 1 100.0 -3.4028234663852886E+38 3.4028234663852886E+38 ECU_ADDRESS 0x436250 /end MEASUREMENT
/begin MEASUREMENT runnableModels.ResetFunctionality.ResetStateMachine_instance_2.setDone "" UBYTE esdl_ident 1 100.0 0 1 ECU_ADDRESS 0x436262 BIT_MASK 0x1 /end MEASUREMENT
/begin MEASUREMENT runnableModels.ResetFunctionality.ResetStateMachine_instance_2.noFailure "" UBYTE esdl_ident 1 100.0 0 1 ECU_ADDRESS 0x436260 BIT_MASK 0x1 /end MEASUREMENT
/begin MEASUREMENT runnableModels.ResetFunctionality.ResetStateMachine_instance_3.sm "" UBYTE esdl_runnableModels_ResetStateMachineStatemachineStates 1 100.0 0 3 ECU_ADDRESS 0x436283 /end MEASUREMENT
/begin MEASUREMENT runnableModels.ResetFunctionality.ResetStateMachine_instance_3.reset "" UBYTE esdl_ident 1 100.0 0 1 ECU_ADDRESS 0x436281 BIT_MASK 0x1 /end MEASUREMENT
/begin MEASUREMENT runnableModels.ResetFunctionality.ResetStateMachine_instance_3.myDT "" FLOAT32_IEEE esdl_ident 1 100.0 -3.4028234663852886E+38 3.4028234663852886E+38 ECU_ADDRESS 0x436278 /end MEASUREMENT
/begin MEASUREMENT runnableModels.ResetFunctionality.ResetStateMachine_instance_3.delta_xx "" FLOAT32_IEEE esdl_ident 1 100.0 -3.4028234663852886E+38 3.4028234663852886E+38 ECU_ADDRESS 0x436264 /end MEASUREMENT
/begin MEASUREMENT runnableModels.ResetFunctionality.ResetStateMachine_instance_3.mean "" FLOAT32_IEEE esdl_ident 1 100.0 -3.4028234663852886E+38 3.4028234663852886E+38 ECU_ADDRESS 0x436274 /end MEASUREMENT
/begin MEASUREMENT runnableModels.ResetFunctionality.ResetStateMachine_instance_3.new_limit "" FLOAT32_IEEE esdl_ident 1 100.0 -3.4028234663852886E+38 3.4028234663852886E+38 ECU_ADDRESS 0x43627C /end MEASUREMENT
/begin MEASUREMENT runnableModels.ResetFunctionality.ResetStateMachine_instance_3.duration "" FLOAT32_IEEE esdl_ident 1 100.0 -3.4028234663852886E+38 3.4028234663852886E+38 ECU_ADDRESS 0x43626C /end MEASUREMENT
/begin MEASUREMENT runnableModels.ResetFunctionality.ResetStateMachine_instance_3.diff_xx "" FLOAT32_IEEE esdl_ident 1 100.0 -3.4028234663852886E+38 3.4028234663852886E+38 ECU_ADDRESS 0x436268 /end MEASUREMENT
/begin MEASUREMENT runnableModels.ResetFunctionality.ResetStateMachine_instance_3.limit "" FLOAT32_IEEE esdl_ident 1 100.0 -3.4028234663852886E+38 3.4028234663852886E+38 ECU_ADDRESS 0x436270 /end MEASUREMENT
/begin MEASUREMENT runnableModels.ResetFunctionality.ResetStateMachine_instance_3.setDone "" UBYTE esdl_ident 1 100.0 0 1 ECU_ADDRESS 0x436282 BIT_MASK 0x1 /end MEASUREMENT
/begin MEASUREMENT runnableModels.ResetFunctionality.ResetStateMachine_instance_3.noFailure "" UBYTE esdl_ident 1 100.0 0 1 ECU_ADDRESS 0x436280 BIT_MASK 0x1 /end MEASUREMENT
/begin MEASUREMENT runnableModels.ResetFunctionality.ResetStateMachine_instance_4.sm "" UBYTE esdl_runnableModels_ResetStateMachineStatemachineStates 1 100.0 0 3 ECU_ADDRESS 0x4362A3 /end MEASUREMENT
/begin MEASUREMENT runnableModels.ResetFunctionality.ResetStateMachine_instance_4.reset "" UBYTE esdl_ident 1 100.0 0 1 ECU_ADDRESS 0x4362A1 BIT_MASK 0x1 /end MEASUREMENT
/begin MEASUREMENT runnableModels.ResetFunctionality.ResetStateMachine_instance_4.myDT "" FLOAT32_IEEE esdl_ident 1 100.0 -3.4028234663852886E+38 3.4028234663852886E+38 ECU_ADDRESS 0x436298 /end MEASUREMENT
/begin MEASUREMENT runnableModels.ResetFunctionality.ResetStateMachine_instance_4.delta_xx "" FLOAT32_IEEE esdl_ident 1 100.0 -3.4028234663852886E+38 3.4028234663852886E+38 ECU_ADDRESS 0x436284 /end MEASUREMENT
/begin MEASUREMENT runnableModels.ResetFunctionality.ResetStateMachine_instance_4.mean "" FLOAT32_IEEE esdl_ident 1 100.0 -3.4028234663852886E+38 3.4028234663852886E+38 ECU_ADDRESS 0x436294 /end MEASUREMENT
/begin MEASUREMENT runnableModels.ResetFunctionality.ResetStateMachine_instance_4.new_limit "" FLOAT32_IEEE esdl_ident 1 100.0 -3.4028234663852886E+38 3.4028234663852886E+38 ECU_ADDRESS 0x43629C /end MEASUREMENT
/begin MEASUREMENT runnableModels.ResetFunctionality.ResetStateMachine_instance_4.duration "" FLOAT32_IEEE esdl_ident 1 100.0 -3.4028234663852886E+38 3.4028234663852886E+38 ECU_ADDRESS 0x43628C /end MEASUREMENT
/begin MEASUREMENT runnableModels.ResetFunctionality.ResetStateMachine_instance_4.diff_xx "" FLOAT32_IEEE esdl_ident 1 100.0 -3.4028234663852886E+38 3.4028234663852886E+38 ECU_ADDRESS 0x436288 /end MEASUREMENT
/begin MEASUREMENT runnableModels.ResetFunctionality.ResetStateMachine_instance_4.limit "" FLOAT32_IEEE esdl_ident 1 100.0 -3.4028234663852886E+38 3.4028234663852886E+38 ECU_ADDRESS 0x436290 /end MEASUREMENT
/begin MEASUREMENT runnableModels.ResetFunctionality.ResetStateMachine_instance_4.setDone "" UBYTE esdl_ident 1 100.0 0 1 ECU_ADDRESS 0x4362A2 BIT_MASK 0x1 /end MEASUREMENT
/begin MEASUREMENT runnableModels.ResetFunctionality.ResetStateMachine_instance_4.noFailure "" UBYTE esdl_ident 1 100.0 0 1 ECU_ADDRESS 0x4362A0 BIT_MASK 0x1 /end MEASUREMENT
/begin COMPU_METHOD esdl_components_SOS_stateStatemachineStates "" TAB_VERB "%12.4" "" /* compu_tab_ref */ COMPU_TAB_REF esdl_components_SOS_stateStatemachineStates_vtab /end COMPU_METHOD
/begin COMPU_VTAB esdl_components_SOS_stateStatemachineStates_vtab "" TAB_VERB /* number value pairs */ 5 2 "beep_short" 4 "no_short" 1 "beep_long" 3 "no_long" 0 "off" /* default value */ DEFAULT_VALUE "Error" /end COMPU_VTAB
/begin COMPU_METHOD esdl_ident "" RAT_FUNC "%12.4" "" /* coeffs */ COEFFS 0 1 0 0 0 1 /end COMPU_METHOD
/begin COMPU_METHOD esdl_runnableModels_ResetStateMachineStatemachineStates "" TAB_VERB "%12.4" "" /* compu_tab_ref */ COMPU_TAB_REF esdl_runnableModels_ResetStateMachineStatemachineStates_vtab /end COMPU_METHOD
/begin COMPU_VTAB esdl_runnableModels_ResetStateMachineStatemachineStates_vtab "" TAB_VERB /* number value pairs */ 4 0 "DoNothing" 3 "WaitForReset" 1 "Reset" 2 "WaitForGo" /* default value */ DEFAULT_VALUE "Error" /end COMPU_VTAB
/begin FUNCTION AscetTireSimApp ""
 /begin SUB_FUNCTION runnableModels.sim_statemachine components.Globals runnableModels.Simulation runnableModels.Driver runnableModels.TirePressureMonitoring runnableModels.ResetFunctionality /end SUB_FUNCTION
/end FUNCTION
/begin FUNCTION runnableModels.sim_statemachine "" /begin DEF_CHARACTERISTIC runnableModels.sim_statemachine.failure /end DEF_CHARACTERISTIC /begin IN_MEASUREMENT interfaces.interfaces.failure_detected /end IN_MEASUREMENT /begin SUB_FUNCTION runnableModels.sim_statemachine.SOS_state_instance /end SUB_FUNCTION /end FUNCTION
/begin FUNCTION runnableModels.sim_statemachine.SOS_state_instance ""
 /begin LOC_MEASUREMENT runnableModels.sim_statemachine.SOS_state_instance.aktiv runnableModels.sim_statemachine.SOS_state_instance.duration runnableModels.sim_statemachine.SOS_state_instance.myDT runnableModels.sim_statemachine.SOS_state_instance.run runnableModels.sim_statemachine.SOS_state_instance.sm runnableModels.sim_statemachine.SOS_state_instance.statelocation runnableModels.sim_statemachine.SOS_state_instance.status runnableModels.sim_statemachine.SOS_state_instance.x runnableModels.sim_statemachine.SOS_state_instance.y /end LOC_MEASUREMENT
/end FUNCTION
/begin FUNCTION components.Globals ""
 /begin LOC_MEASUREMENT components.Globals.limit components.Globals.limit_FL components.Globals.limit_FR components.Globals.limit_RL components.Globals.limit_RR /end LOC_MEASUREMENT
/end FUNCTION
/begin FUNCTION runnableModels.Simulation ""
 /begin DEF_CHARACTERISTIC runnableModels.Simulation.status_tire runnableModels.Simulation.base_v runnableModels.Simulation.base_noiselevel /end DEF_CHARACTERISTIC
 /begin IN_MEASUREMENT interfaces.interfaces.vfl interfaces.interfaces.vfr interfaces.interfaces.vrl interfaces.interfaces.vrr /end IN_MEASUREMENT
 /begin OUT_MEASUREMENT interfaces.interfaces.delta_sfl interfaces.interfaces.delta_sfr interfaces.interfaces.delta_srl interfaces.interfaces.delta_srr interfaces.interfaces.failure_detected interfaces.interfaces.sfl interfaces.interfaces.sfr interfaces.interfaces.srl interfaces.interfaces.srr /end OUT_MEASUREMENT
 /begin LOC_MEASUREMENT runnableModels.Simulation.diff_sfl runnableModels.Simulation.diff_sfr runnableModels.Simulation.diff_srl runnableModels.Simulation.diff_srr runnableModels.Simulation.fl_failure runnableModels.Simulation.fr_failure runnableModels.Simulation.mean runnableModels.Simulation.rand runnableModels.Simulation.rl_failure runnableModels.Simulation.rr_failure runnableModels.Simulation.sfl runnableModels.Simulation.sfr runnableModels.Simulation.srl runnableModels.Simulation.srr runnableModels.Simulation.vfl runnableModels.Simulation.vfr runnableModels.Simulation.vrl runnableModels.Simulation.vrr /end LOC_MEASUREMENT
 /begin SUB_FUNCTION runnableModels.Simulation.Model_instance runnableModels.Simulation.TireMean_instance runnableModels.Simulation.TireDeviation_instance runnableModels.Simulation.RandomGenerator_instance /end SUB_FUNCTION
/end FUNCTION
/begin FUNCTION runnableModels.Simulation.Model_instance ""
 /begin LOC_MEASUREMENT runnableModels.Simulation.Model_instance.delta_sfl runnableModels.Simulation.Model_instance.delta_sfr runnableModels.Simulation.Model_instance.delta_srl runnableModels.Simulation.Model_instance.delta_srr runnableModels.Simulation.Model_instance.sfl runnableModels.Simulation.Model_instance.sfl_before runnableModels.Simulation.Model_instance.sfr runnableModels.Simulation.Model_instance.sfr_before runnableModels.Simulation.Model_instance.srl runnableModels.Simulation.Model_instance.srl_before runnableModels.Simulation.Model_instance.srr runnableModels.Simulation.Model_instance.srr_before /end LOC_MEASUREMENT
 /begin SUB_FUNCTION runnableModels.Simulation.Model_instance.RingBuffer_instance runnableModels.Simulation.Model_instance.RingBuffer_instance_2 runnableModels.Simulation.Model_instance.RingBuffer_instance_3 runnableModels.Simulation.Model_instance.RingBuffer_instance_4 /end SUB_FUNCTION
/end FUNCTION
/begin FUNCTION runnableModels.Simulation.Model_instance.RingBuffer_instance ""
 /begin LOC_MEASUREMENT runnableModels.Simulation.Model_instance.RingBuffer_instance.buffer runnableModels.Simulation.Model_instance.RingBuffer_instance.c runnableModels.Simulation.Model_instance.RingBuffer_instance.swap /end LOC_MEASUREMENT
/end FUNCTION
/begin FUNCTION runnableModels.Simulation.Model_instance.RingBuffer_instance_2 ""
 /begin LOC_MEASUREMENT runnableModels.Simulation.Model_instance.RingBuffer_instance_2.buffer runnableModels.Simulation.Model_instance.RingBuffer_instance_2.c runnableModels.Simulation.Model_instance.RingBuffer_instance_2.swap /end LOC_MEASUREMENT
/end FUNCTION
/begin FUNCTION runnableModels.Simulation.Model_instance.RingBuffer_instance_3 ""
 /begin LOC_MEASUREMENT runnableModels.Simulation.Model_instance.RingBuffer_instance_3.buffer runnableModels.Simulation.Model_instance.RingBuffer_instance_3.c runnableModels.Simulation.Model_instance.RingBuffer_instance_3.swap /end LOC_MEASUREMENT
/end FUNCTION
/begin FUNCTION runnableModels.Simulation.Model_instance.RingBuffer_instance_4 ""
 /begin LOC_MEASUREMENT runnableModels.Simulation.Model_instance.RingBuffer_instance_4.buffer runnableModels.Simulation.Model_instance.RingBuffer_instance_4.c runnableModels.Simulation.Model_instance.RingBuffer_instance_4.swap /end LOC_MEASUREMENT
/end FUNCTION
/begin FUNCTION runnableModels.Simulation.TireMean_instance "" /end FUNCTION
/begin FUNCTION runnableModels.Simulation.TireDeviation_instance ""
 /begin LOC_MEASUREMENT runnableModels.Simulation.TireDeviation_instance.diff runnableModels.Simulation.TireDeviation_instance.limit runnableModels.Simulation.TireDeviation_instance.mean runnableModels.Simulation.TireDeviation_instance.v /end LOC_MEASUREMENT
/end FUNCTION
/begin FUNCTION runnableModels.Simulation.RandomGenerator_instance ""
 /begin DEF_CHARACTERISTIC runnableModels.Simulation.RandomGenerator_instance.a runnableModels.Simulation.RandomGenerator_instance.m runnableModels.Simulation.RandomGenerator_instance.c /end DEF_CHARACTERISTIC
 /begin LOC_MEASUREMENT runnableModels.Simulation.RandomGenerator_instance.seed runnableModels.Simulation.RandomGenerator_instance.x /end LOC_MEASUREMENT
/end FUNCTION
/begin FUNCTION runnableModels.Driver ""
 /begin DEF_CHARACTERISTIC runnableModels.Driver.base_v runnableModels.Driver.base_noiselevel runnableModels.Driver.deflate_fr runnableModels.Driver.deflate_fl runnableModels.Driver.deflate_vrl runnableModels.Driver.deflate_vrr runnableModels.Driver.error_FR runnableModels.Driver.error_FL runnableModels.Driver.error_RL runnableModels.Driver.error_RR /end DEF_CHARACTERISTIC
 /begin IN_MEASUREMENT interfaces.interfaces.mean /end IN_MEASUREMENT
 /begin OUT_MEASUREMENT interfaces.interfaces.vfl interfaces.interfaces.vfr interfaces.interfaces.vrl interfaces.interfaces.vrr /end OUT_MEASUREMENT
 /begin LOC_MEASUREMENT runnableModels.Driver.rand /end LOC_MEASUREMENT
 /begin SUB_FUNCTION runnableModels.Driver.RandomGenerator_instance runnableModels.Driver.RandomGenerator_instance_2 runnableModels.Driver.RandomGenerator_instance_3 runnableModels.Driver.RandomGenerator_instance_4 runnableModels.Driver.ErrorModule_instance runnableModels.Driver.ErrorModule_instance_2 runnableModels.Driver.ErrorModule_instance_3 runnableModels.Driver.ErrorModule_instance_4 /end SUB_FUNCTION
/end FUNCTION
/begin FUNCTION runnableModels.Driver.RandomGenerator_instance ""
 /begin DEF_CHARACTERISTIC runnableModels.Driver.RandomGenerator_instance.a runnableModels.Driver.RandomGenerator_instance.m runnableModels.Driver.RandomGenerator_instance.c /end DEF_CHARACTERISTIC
 /begin LOC_MEASUREMENT runnableModels.Driver.RandomGenerator_instance.seed runnableModels.Driver.RandomGenerator_instance.x /end LOC_MEASUREMENT
/end FUNCTION
/begin FUNCTION runnableModels.Driver.RandomGenerator_instance_2 ""
 /begin DEF_CHARACTERISTIC runnableModels.Driver.RandomGenerator_instance_2.a runnableModels.Driver.RandomGenerator_instance_2.m runnableModels.Driver.RandomGenerator_instance_2.c /end DEF_CHARACTERISTIC
 /begin LOC_MEASUREMENT runnableModels.Driver.RandomGenerator_instance_2.seed runnableModels.Driver.RandomGenerator_instance_2.x /end LOC_MEASUREMENT
/end FUNCTION
/begin FUNCTION runnableModels.Driver.RandomGenerator_instance_3 ""
 /begin DEF_CHARACTERISTIC runnableModels.Driver.RandomGenerator_instance_3.a runnableModels.Driver.RandomGenerator_instance_3.m runnableModels.Driver.RandomGenerator_instance_3.c /end DEF_CHARACTERISTIC
 /begin LOC_MEASUREMENT runnableModels.Driver.RandomGenerator_instance_3.seed runnableModels.Driver.RandomGenerator_instance_3.x /end LOC_MEASUREMENT
/end FUNCTION
/begin FUNCTION runnableModels.Driver.RandomGenerator_instance_4 ""
 /begin DEF_CHARACTERISTIC runnableModels.Driver.RandomGenerator_instance_4.a runnableModels.Driver.RandomGenerator_instance_4.m runnableModels.Driver.RandomGenerator_instance_4.c /end DEF_CHARACTERISTIC
 /begin LOC_MEASUREMENT runnableModels.Driver.RandomGenerator_instance_4.seed runnableModels.Driver.RandomGenerator_instance_4.x /end LOC_MEASUREMENT
/end FUNCTION
/begin FUNCTION runnableModels.Driver.ErrorModule_instance "" /end FUNCTION
/begin FUNCTION runnableModels.Driver.ErrorModule_instance_2 "" /end FUNCTION
/begin FUNCTION runnableModels.Driver.ErrorModule_instance_3 "" /end FUNCTION
/begin FUNCTION runnableModels.Driver.ErrorModule_instance_4 "" /end FUNCTION
/begin FUNCTION runnableModels.TirePressureMonitoring ""
 /begin IN_MEASUREMENT interfaces.interfaces.delta_sfl interfaces.interfaces.delta_sfr interfaces.interfaces.delta_srl interfaces.interfaces.delta_srr interfaces.interfaces.noFailure interfaces.interfaces.srl /end IN_MEASUREMENT
 /begin OUT_MEASUREMENT interfaces.interfaces.failure_detected interfaces.interfaces.mean /end OUT_MEASUREMENT
 /begin LOC_MEASUREMENT runnableModels.TirePressureMonitoring.diff_sfl runnableModels.TirePressureMonitoring.diff_sfr runnableModels.TirePressureMonitoring.diff_srl runnableModels.TirePressureMonitoring.diff_srr runnableModels.TirePressureMonitoring.fl_failure runnableModels.TirePressureMonitoring.fr_failure runnableModels.TirePressureMonitoring.mean runnableModels.TirePressureMonitoring.rl_failure runnableModels.TirePressureMonitoring.rr_failure runnableModels.TirePressureMonitoring.test /end LOC_MEASUREMENT
 /begin SUB_FUNCTION runnableModels.TirePressureMonitoring.TireMean_instance runnableModels.TirePressureMonitoring.TireDeviation_instance runnableModels.TirePressureMonitoring.TireDeviation_instance_2 runnableModels.TirePressureMonitoring.TireDeviation_instance_3 runnableModels.TirePressureMonitoring.TireDeviation_instance_4 /end SUB_FUNCTION
/end FUNCTION
/begin FUNCTION runnableModels.TirePressureMonitoring.TireMean_instance "" /end FUNCTION
/begin FUNCTION runnableModels.TirePressureMonitoring.TireDeviation_instance ""
 /begin LOC_MEASUREMENT runnableModels.TirePressureMonitoring.TireDeviation_instance.diff runnableModels.TirePressureMonitoring.TireDeviation_instance.limit runnableModels.TirePressureMonitoring.TireDeviation_instance.mean runnableModels.TirePressureMonitoring.TireDeviation_instance.v /end LOC_MEASUREMENT
/end FUNCTION
/begin FUNCTION runnableModels.TirePressureMonitoring.TireDeviation_instance_2 ""
 /begin LOC_MEASUREMENT runnableModels.TirePressureMonitoring.TireDeviation_instance_2.diff runnableModels.TirePressureMonitoring.TireDeviation_instance_2.limit runnableModels.TirePressureMonitoring.TireDeviation_instance_2.mean runnableModels.TirePressureMonitoring.TireDeviation_instance_2.v /end LOC_MEASUREMENT
/end FUNCTION
/begin FUNCTION runnableModels.TirePressureMonitoring.TireDeviation_instance_3 ""
 /begin LOC_MEASUREMENT runnableModels.TirePressureMonitoring.TireDeviation_instance_3.diff runnableModels.TirePressureMonitoring.TireDeviation_instance_3.limit runnableModels.TirePressureMonitoring.TireDeviation_instance_3.mean runnableModels.TirePressureMonitoring.TireDeviation_instance_3.v /end LOC_MEASUREMENT
/end FUNCTION
/begin FUNCTION runnableModels.TirePressureMonitoring.TireDeviation_instance_4 ""
 /begin LOC_MEASUREMENT runnableModels.TirePressureMonitoring.TireDeviation_instance_4.diff runnableModels.TirePressureMonitoring.TireDeviation_instance_4.limit runnableModels.TirePressureMonitoring.TireDeviation_instance_4.mean runnableModels.TirePressureMonitoring.TireDeviation_instance_4.v /end LOC_MEASUREMENT
/end FUNCTION
/begin FUNCTION runnableModels.ResetFunctionality "" /begin DEF_CHARACTERISTIC runnableModels.ResetFunctionality.ResetButton /end DEF_CHARACTERISTIC
 /begin IN_MEASUREMENT interfaces.interfaces.delta_sfl interfaces.interfaces.delta_sfr interfaces.interfaces.delta_srl interfaces.interfaces.delta_srr interfaces.interfaces.mean interfaces.interfaces.sfl interfaces.interfaces.sfr interfaces.interfaces.srl interfaces.interfaces.srr interfaces.interfaces.vfl interfaces.interfaces.vfr interfaces.interfaces.vrl interfaces.interfaces.vrr /end IN_MEASUREMENT
 /begin OUT_MEASUREMENT interfaces.interfaces.noFailure /end OUT_MEASUREMENT
 /begin LOC_MEASUREMENT runnableModels.ResetFunctionality.exitState runnableModels.ResetFunctionality.restValid runnableModels.ResetFunctionality.test /end LOC_MEASUREMENT
 /begin SUB_FUNCTION runnableModels.ResetFunctionality.Reset_instance runnableModels.ResetFunctionality.ResetStateMachine_instance runnableModels.ResetFunctionality.ResetStateMachine_instance_2 runnableModels.ResetFunctionality.ResetStateMachine_instance_3 runnableModels.ResetFunctionality.ResetStateMachine_instance_4 /end SUB_FUNCTION
/end FUNCTION
/begin FUNCTION runnableModels.ResetFunctionality.Reset_instance "" /end FUNCTION
/begin FUNCTION runnableModels.ResetFunctionality.ResetStateMachine_instance ""
 /begin LOC_MEASUREMENT runnableModels.ResetFunctionality.ResetStateMachine_instance.delta_xx runnableModels.ResetFunctionality.ResetStateMachine_instance.diff_xx runnableModels.ResetFunctionality.ResetStateMachine_instance.duration runnableModels.ResetFunctionality.ResetStateMachine_instance.limit runnableModels.ResetFunctionality.ResetStateMachine_instance.mean runnableModels.ResetFunctionality.ResetStateMachine_instance.myDT runnableModels.ResetFunctionality.ResetStateMachine_instance.new_limit runnableModels.ResetFunctionality.ResetStateMachine_instance.noFailure runnableModels.ResetFunctionality.ResetStateMachine_instance.reset runnableModels.ResetFunctionality.ResetStateMachine_instance.setDone runnableModels.ResetFunctionality.ResetStateMachine_instance.sm /end LOC_MEASUREMENT
/end FUNCTION
/begin FUNCTION runnableModels.ResetFunctionality.ResetStateMachine_instance_2 ""
 /begin LOC_MEASUREMENT runnableModels.ResetFunctionality.ResetStateMachine_instance_2.delta_xx runnableModels.ResetFunctionality.ResetStateMachine_instance_2.diff_xx runnableModels.ResetFunctionality.ResetStateMachine_instance_2.duration runnableModels.ResetFunctionality.ResetStateMachine_instance_2.limit runnableModels.ResetFunctionality.ResetStateMachine_instance_2.mean runnableModels.ResetFunctionality.ResetStateMachine_instance_2.myDT runnableModels.ResetFunctionality.ResetStateMachine_instance_2.new_limit runnableModels.ResetFunctionality.ResetStateMachine_instance_2.noFailure runnableModels.ResetFunctionality.ResetStateMachine_instance_2.reset runnableModels.ResetFunctionality.ResetStateMachine_instance_2.setDone runnableModels.ResetFunctionality.ResetStateMachine_instance_2.sm /end LOC_MEASUREMENT
/end FUNCTION
/begin FUNCTION runnableModels.ResetFunctionality.ResetStateMachine_instance_3 ""
 /begin LOC_MEASUREMENT runnableModels.ResetFunctionality.ResetStateMachine_instance_3.delta_xx runnableModels.ResetFunctionality.ResetStateMachine_instance_3.diff_xx runnableModels.ResetFunctionality.ResetStateMachine_instance_3.duration runnableModels.ResetFunctionality.ResetStateMachine_instance_3.limit runnableModels.ResetFunctionality.ResetStateMachine_instance_3.mean runnableModels.ResetFunctionality.ResetStateMachine_instance_3.myDT runnableModels.ResetFunctionality.ResetStateMachine_instance_3.new_limit runnableModels.ResetFunctionality.ResetStateMachine_instance_3.noFailure runnableModels.ResetFunctionality.ResetStateMachine_instance_3.reset runnableModels.ResetFunctionality.ResetStateMachine_instance_3.setDone runnableModels.ResetFunctionality.ResetStateMachine_instance_3.sm /end LOC_MEASUREMENT
/end FUNCTION
/begin FUNCTION runnableModels.ResetFunctionality.ResetStateMachine_instance_4 ""
 /begin LOC_MEASUREMENT runnableModels.ResetFunctionality.ResetStateMachine_instance_4.delta_xx runnableModels.ResetFunctionality.ResetStateMachine_instance_4.diff_xx runnableModels.ResetFunctionality.ResetStateMachine_instance_4.duration runnableModels.ResetFunctionality.ResetStateMachine_instance_4.limit runnableModels.ResetFunctionality.ResetStateMachine_instance_4.mean runnableModels.ResetFunctionality.ResetStateMachine_instance_4.myDT runnableModels.ResetFunctionality.ResetStateMachine_instance_4.new_limit runnableModels.ResetFunctionality.ResetStateMachine_instance_4.noFailure runnableModels.ResetFunctionality.ResetStateMachine_instance_4.reset runnableModels.ResetFunctionality.ResetStateMachine_instance_4.setDone runnableModels.ResetFunctionality.ResetStateMachine_instance_4.sm /end LOC_MEASUREMENT
/end FUNCTION
/begin RECORD_LAYOUT STANDARD_VALUE_U8 FNC_VALUES 1 UBYTE COLUMN_DIR DIRECT /end RECORD_LAYOUT
/begin RECORD_LAYOUT STANDARD_VALUE_R32 FNC_VALUES 1 FLOAT32_IEEE COLUMN_DIR DIRECT /end RECORD_LAYOUT
/begin RECORD_LAYOUT STANDARD_VALUE_U16 FNC_VALUES 1 UWORD COLUMN_DIR DIRECT /end RECORD_LAYOUT
/begin GROUP AscetTireSimApp "" ROOT
 /begin SUB_GROUP runnableModels.sim_statemachine interfaces.interfaces components.Globals runnableModels.Simulation runnableModels.Driver runnableModels.TirePressureMonitoring runnableModels.ResetFunctionality /end SUB_GROUP
/end GROUP
/begin GROUP runnableModels.sim_statemachine "" /begin REF_CHARACTERISTIC runnableModels.sim_statemachine.failure /end REF_CHARACTERISTIC /begin SUB_GROUP runnableModels.sim_statemachine.SOS_state_instance /end SUB_GROUP /end GROUP
/begin GROUP runnableModels.sim_statemachine.SOS_state_instance ""
 /begin REF_MEASUREMENT runnableModels.sim_statemachine.SOS_state_instance.aktiv runnableModels.sim_statemachine.SOS_state_instance.duration runnableModels.sim_statemachine.SOS_state_instance.myDT runnableModels.sim_statemachine.SOS_state_instance.run runnableModels.sim_statemachine.SOS_state_instance.sm runnableModels.sim_statemachine.SOS_state_instance.statelocation runnableModels.sim_statemachine.SOS_state_instance.status runnableModels.sim_statemachine.SOS_state_instance.x runnableModels.sim_statemachine.SOS_state_instance.y /end REF_MEASUREMENT
/end GROUP
/begin GROUP interfaces.interfaces ""
 /begin REF_MEASUREMENT interfaces.interfaces.delta_sfl interfaces.interfaces.delta_sfr interfaces.interfaces.delta_srl interfaces.interfaces.delta_srr interfaces.interfaces.failure_detected interfaces.interfaces.mean interfaces.interfaces.noFailure interfaces.interfaces.sfl interfaces.interfaces.sfr interfaces.interfaces.srl interfaces.interfaces.srr interfaces.interfaces.vfl interfaces.interfaces.vfr interfaces.interfaces.vrl interfaces.interfaces.vrr /end REF_MEASUREMENT
/end GROUP
/begin GROUP components.Globals ""
 /begin REF_MEASUREMENT components.Globals.limit components.Globals.limit_FL components.Globals.limit_FR components.Globals.limit_RL components.Globals.limit_RR /end REF_MEASUREMENT
/end GROUP
/begin GROUP runnableModels.Simulation ""
 /begin REF_CHARACTERISTIC runnableModels.Simulation.status_tire runnableModels.Simulation.base_v runnableModels.Simulation.base_noiselevel /end REF_CHARACTERISTIC
 /begin REF_MEASUREMENT runnableModels.Simulation.diff_sfl runnableModels.Simulation.diff_sfr runnableModels.Simulation.diff_srl runnableModels.Simulation.diff_srr runnableModels.Simulation.fl_failure runnableModels.Simulation.fr_failure runnableModels.Simulation.mean runnableModels.Simulation.rand runnableModels.Simulation.rl_failure runnableModels.Simulation.rr_failure runnableModels.Simulation.sfl runnableModels.Simulation.sfr runnableModels.Simulation.srl runnableModels.Simulation.srr runnableModels.Simulation.vfl runnableModels.Simulation.vfr runnableModels.Simulation.vrl runnableModels.Simulation.vrr /end REF_MEASUREMENT
 /begin SUB_GROUP runnableModels.Simulation.Model_instance runnableModels.Simulation.TireMean_instance runnableModels.Simulation.TireDeviation_instance runnableModels.Simulation.RandomGenerator_instance /end SUB_GROUP
/end GROUP
/begin GROUP runnableModels.Simulation.Model_instance ""
 /begin REF_MEASUREMENT runnableModels.Simulation.Model_instance.delta_sfl runnableModels.Simulation.Model_instance.delta_sfr runnableModels.Simulation.Model_instance.delta_srl runnableModels.Simulation.Model_instance.delta_srr runnableModels.Simulation.Model_instance.sfl runnableModels.Simulation.Model_instance.sfl_before runnableModels.Simulation.Model_instance.sfr runnableModels.Simulation.Model_instance.sfr_before runnableModels.Simulation.Model_instance.srl runnableModels.Simulation.Model_instance.srl_before runnableModels.Simulation.Model_instance.srr runnableModels.Simulation.Model_instance.srr_before /end REF_MEASUREMENT
 /begin SUB_GROUP runnableModels.Simulation.Model_instance.RingBuffer_instance runnableModels.Simulation.Model_instance.RingBuffer_instance_2 runnableModels.Simulation.Model_instance.RingBuffer_instance_3 runnableModels.Simulation.Model_instance.RingBuffer_instance_4 /end SUB_GROUP
/end GROUP
/begin GROUP runnableModels.Simulation.Model_instance.RingBuffer_instance ""
 /begin REF_MEASUREMENT runnableModels.Simulation.Model_instance.RingBuffer_instance.buffer runnableModels.Simulation.Model_instance.RingBuffer_instance.c runnableModels.Simulation.Model_instance.RingBuffer_instance.swap /end REF_MEASUREMENT
/end GROUP
/begin GROUP runnableModels.Simulation.Model_instance.RingBuffer_instance_2 ""
 /begin REF_MEASUREMENT runnableModels.Simulation.Model_instance.RingBuffer_instance_2.buffer runnableModels.Simulation.Model_instance.RingBuffer_instance_2.c runnableModels.Simulation.Model_instance.RingBuffer_instance_2.swap /end REF_MEASUREMENT
/end GROUP
/begin GROUP runnableModels.Simulation.Model_instance.RingBuffer_instance_3 ""
 /begin REF_MEASUREMENT runnableModels.Simulation.Model_instance.RingBuffer_instance_3.buffer runnableModels.Simulation.Model_instance.RingBuffer_instance_3.c runnableModels.Simulation.Model_instance.RingBuffer_instance_3.swap /end REF_MEASUREMENT
/end GROUP
/begin GROUP runnableModels.Simulation.Model_instance.RingBuffer_instance_4 ""
 /begin REF_MEASUREMENT runnableModels.Simulation.Model_instance.RingBuffer_instance_4.buffer runnableModels.Simulation.Model_instance.RingBuffer_instance_4.c runnableModels.Simulation.Model_instance.RingBuffer_instance_4.swap /end REF_MEASUREMENT
/end GROUP
/begin GROUP runnableModels.Simulation.TireMean_instance "" /end GROUP
/begin GROUP runnableModels.Simulation.TireDeviation_instance ""
 /begin REF_MEASUREMENT runnableModels.Simulation.TireDeviation_instance.diff runnableModels.Simulation.TireDeviation_instance.limit runnableModels.Simulation.TireDeviation_instance.mean runnableModels.Simulation.TireDeviation_instance.v /end REF_MEASUREMENT
/end GROUP
/begin GROUP runnableModels.Simulation.RandomGenerator_instance ""
 /begin REF_CHARACTERISTIC runnableModels.Simulation.RandomGenerator_instance.a runnableModels.Simulation.RandomGenerator_instance.m runnableModels.Simulation.RandomGenerator_instance.c /end REF_CHARACTERISTIC
 /begin REF_MEASUREMENT runnableModels.Simulation.RandomGenerator_instance.seed runnableModels.Simulation.RandomGenerator_instance.x /end REF_MEASUREMENT
/end GROUP
/begin GROUP runnableModels.Driver ""
 /begin REF_CHARACTERISTIC runnableModels.Driver.base_v runnableModels.Driver.base_noiselevel runnableModels.Driver.deflate_fr runnableModels.Driver.deflate_fl runnableModels.Driver.deflate_vrl runnableModels.Driver.deflate_vrr runnableModels.Driver.error_FR runnableModels.Driver.error_FL runnableModels.Driver.error_RL runnableModels.Driver.error_RR /end REF_CHARACTERISTIC
 /begin REF_MEASUREMENT runnableModels.Driver.rand /end REF_MEASUREMENT
 /begin SUB_GROUP runnableModels.Driver.RandomGenerator_instance runnableModels.Driver.RandomGenerator_instance_2 runnableModels.Driver.RandomGenerator_instance_3 runnableModels.Driver.RandomGenerator_instance_4 runnableModels.Driver.ErrorModule_instance runnableModels.Driver.ErrorModule_instance_2 runnableModels.Driver.ErrorModule_instance_3 runnableModels.Driver.ErrorModule_instance_4 /end SUB_GROUP
/end GROUP
/begin GROUP runnableModels.Driver.RandomGenerator_instance ""
 /begin REF_CHARACTERISTIC runnableModels.Driver.RandomGenerator_instance.a runnableModels.Driver.RandomGenerator_instance.m runnableModels.Driver.RandomGenerator_instance.c /end REF_CHARACTERISTIC
 /begin REF_MEASUREMENT runnableModels.Driver.RandomGenerator_instance.seed runnableModels.Driver.RandomGenerator_instance.x /end REF_MEASUREMENT
/end GROUP
/begin GROUP runnableModels.Driver.RandomGenerator_instance_2 ""
 /begin REF_CHARACTERISTIC runnableModels.Driver.RandomGenerator_instance_2.a runnableModels.Driver.RandomGenerator_instance_2.m runnableModels.Driver.RandomGenerator_instance_2.c /end REF_CHARACTERISTIC
 /begin REF_MEASUREMENT runnableModels.Driver.RandomGenerator_instance_2.seed runnableModels.Driver.RandomGenerator_instance_2.x /end REF_MEASUREMENT
/end GROUP
/begin GROUP runnableModels.Driver.RandomGenerator_instance_3 ""
 /begin REF_CHARACTERISTIC runnableModels.Driver.RandomGenerator_instance_3.a runnableModels.Driver.RandomGenerator_instance_3.m runnableModels.Driver.RandomGenerator_instance_3.c /end REF_CHARACTERISTIC
 /begin REF_MEASUREMENT runnableModels.Driver.RandomGenerator_instance_3.seed runnableModels.Driver.RandomGenerator_instance_3.x /end REF_MEASUREMENT
/end GROUP
/begin GROUP runnableModels.Driver.RandomGenerator_instance_4 ""
 /begin REF_CHARACTERISTIC runnableModels.Driver.RandomGenerator_instance_4.a runnableModels.Driver.RandomGenerator_instance_4.m runnableModels.Driver.RandomGenerator_instance_4.c /end REF_CHARACTERISTIC
 /begin REF_MEASUREMENT runnableModels.Driver.RandomGenerator_instance_4.seed runnableModels.Driver.RandomGenerator_instance_4.x /end REF_MEASUREMENT
/end GROUP
/begin GROUP runnableModels.Driver.ErrorModule_instance "" /end GROUP
/begin GROUP runnableModels.Driver.ErrorModule_instance_2 "" /end GROUP
/begin GROUP runnableModels.Driver.ErrorModule_instance_3 "" /end GROUP
/begin GROUP runnableModels.Driver.ErrorModule_instance_4 "" /end GROUP
/begin GROUP runnableModels.TirePressureMonitoring ""
 /begin REF_MEASUREMENT runnableModels.TirePressureMonitoring.diff_sfl runnableModels.TirePressureMonitoring.diff_sfr runnableModels.TirePressureMonitoring.diff_srl runnableModels.TirePressureMonitoring.diff_srr runnableModels.TirePressureMonitoring.fl_failure runnableModels.TirePressureMonitoring.fr_failure runnableModels.TirePressureMonitoring.mean runnableModels.TirePressureMonitoring.rl_failure runnableModels.TirePressureMonitoring.rr_failure runnableModels.TirePressureMonitoring.test /end REF_MEASUREMENT
 /begin SUB_GROUP runnableModels.TirePressureMonitoring.TireMean_instance runnableModels.TirePressureMonitoring.TireDeviation_instance runnableModels.TirePressureMonitoring.TireDeviation_instance_2 runnableModels.TirePressureMonitoring.TireDeviation_instance_3 runnableModels.TirePressureMonitoring.TireDeviation_instance_4 /end SUB_GROUP
/end GROUP
/begin GROUP runnableModels.TirePressureMonitoring.TireMean_instance "" /end GROUP
/begin GROUP runnableModels.TirePressureMonitoring.TireDeviation_instance ""
 /begin REF_MEASUREMENT runnableModels.TirePressureMonitoring.TireDeviation_instance.diff runnableModels.TirePressureMonitoring.TireDeviation_instance.limit runnableModels.TirePressureMonitoring.TireDeviation_instance.mean runnableModels.TirePressureMonitoring.TireDeviation_instance.v /end REF_MEASUREMENT
/end GROUP
/begin GROUP runnableModels.TirePressureMonitoring.TireDeviation_instance_2 ""
 /begin REF_MEASUREMENT runnableModels.TirePressureMonitoring.TireDeviation_instance_2.diff runnableModels.TirePressureMonitoring.TireDeviation_instance_2.limit runnableModels.TirePressureMonitoring.TireDeviation_instance_2.mean runnableModels.TirePressureMonitoring.TireDeviation_instance_2.v /end REF_MEASUREMENT
/end GROUP
/begin GROUP runnableModels.TirePressureMonitoring.TireDeviation_instance_3 ""
 /begin REF_MEASUREMENT runnableModels.TirePressureMonitoring.TireDeviation_instance_3.diff runnableModels.TirePressureMonitoring.TireDeviation_instance_3.limit runnableModels.TirePressureMonitoring.TireDeviation_instance_3.mean runnableModels.TirePressureMonitoring.TireDeviation_instance_3.v /end REF_MEASUREMENT
/end GROUP
/begin GROUP runnableModels.TirePressureMonitoring.TireDeviation_instance_4 ""
 /begin REF_MEASUREMENT runnableModels.TirePressureMonitoring.TireDeviation_instance_4.diff runnableModels.TirePressureMonitoring.TireDeviation_instance_4.limit runnableModels.TirePressureMonitoring.TireDeviation_instance_4.mean runnableModels.TirePressureMonitoring.TireDeviation_instance_4.v /end REF_MEASUREMENT
/end GROUP
/begin GROUP runnableModels.ResetFunctionality "" /begin REF_CHARACTERISTIC runnableModels.ResetFunctionality.ResetButton /end REF_CHARACTERISTIC
 /begin REF_MEASUREMENT runnableModels.ResetFunctionality.exitState runnableModels.ResetFunctionality.restValid runnableModels.ResetFunctionality.test /end REF_MEASUREMENT
 /begin SUB_GROUP runnableModels.ResetFunctionality.Reset_instance runnableModels.ResetFunctionality.ResetStateMachine_instance runnableModels.ResetFunctionality.ResetStateMachine_instance_2 runnableModels.ResetFunctionality.ResetStateMachine_instance_3 runnableModels.ResetFunctionality.ResetStateMachine_instance_4 /end SUB_GROUP
/end GROUP
/begin GROUP runnableModels.ResetFunctionality.Reset_instance "" /end GROUP
/begin GROUP runnableModels.ResetFunctionality.ResetStateMachine_instance ""
 /begin REF_MEASUREMENT runnableModels.ResetFunctionality.ResetStateMachine_instance.delta_xx runnableModels.ResetFunctionality.ResetStateMachine_instance.diff_xx runnableModels.ResetFunctionality.ResetStateMachine_instance.duration runnableModels.ResetFunctionality.ResetStateMachine_instance.limit runnableModels.ResetFunctionality.ResetStateMachine_instance.mean runnableModels.ResetFunctionality.ResetStateMachine_instance.myDT runnableModels.ResetFunctionality.ResetStateMachine_instance.new_limit runnableModels.ResetFunctionality.ResetStateMachine_instance.noFailure runnableModels.ResetFunctionality.ResetStateMachine_instance.reset runnableModels.ResetFunctionality.ResetStateMachine_instance.setDone runnableModels.ResetFunctionality.ResetStateMachine_instance.sm /end REF_MEASUREMENT
/end GROUP
/begin GROUP runnableModels.ResetFunctionality.ResetStateMachine_instance_2 ""
 /begin REF_MEASUREMENT runnableModels.ResetFunctionality.ResetStateMachine_instance_2.delta_xx runnableModels.ResetFunctionality.ResetStateMachine_instance_2.diff_xx runnableModels.ResetFunctionality.ResetStateMachine_instance_2.duration runnableModels.ResetFunctionality.ResetStateMachine_instance_2.limit runnableModels.ResetFunctionality.ResetStateMachine_instance_2.mean runnableModels.ResetFunctionality.ResetStateMachine_instance_2.myDT runnableModels.ResetFunctionality.ResetStateMachine_instance_2.new_limit runnableModels.ResetFunctionality.ResetStateMachine_instance_2.noFailure runnableModels.ResetFunctionality.ResetStateMachine_instance_2.reset runnableModels.ResetFunctionality.ResetStateMachine_instance_2.setDone runnableModels.ResetFunctionality.ResetStateMachine_instance_2.sm /end REF_MEASUREMENT
/end GROUP
/begin GROUP runnableModels.ResetFunctionality.ResetStateMachine_instance_3 ""
 /begin REF_MEASUREMENT runnableModels.ResetFunctionality.ResetStateMachine_instance_3.delta_xx runnableModels.ResetFunctionality.ResetStateMachine_instance_3.diff_xx runnableModels.ResetFunctionality.ResetStateMachine_instance_3.duration runnableModels.ResetFunctionality.ResetStateMachine_instance_3.limit runnableModels.ResetFunctionality.ResetStateMachine_instance_3.mean runnableModels.ResetFunctionality.ResetStateMachine_instance_3.myDT runnableModels.ResetFunctionality.ResetStateMachine_instance_3.new_limit runnableModels.ResetFunctionality.ResetStateMachine_instance_3.noFailure runnableModels.ResetFunctionality.ResetStateMachine_instance_3.reset runnableModels.ResetFunctionality.ResetStateMachine_instance_3.setDone runnableModels.ResetFunctionality.ResetStateMachine_instance_3.sm /end REF_MEASUREMENT
/end GROUP
/begin GROUP runnableModels.ResetFunctionality.ResetStateMachine_instance_4 ""
 /begin REF_MEASUREMENT runnableModels.ResetFunctionality.ResetStateMachine_instance_4.delta_xx runnableModels.ResetFunctionality.ResetStateMachine_instance_4.diff_xx runnableModels.ResetFunctionality.ResetStateMachine_instance_4.duration runnableModels.ResetFunctionality.ResetStateMachine_instance_4.limit runnableModels.ResetFunctionality.ResetStateMachine_instance_4.mean runnableModels.ResetFunctionality.ResetStateMachine_instance_4.myDT runnableModels.ResetFunctionality.ResetStateMachine_instance_4.new_limit runnableModels.ResetFunctionality.ResetStateMachine_instance_4.noFailure runnableModels.ResetFunctionality.ResetStateMachine_instance_4.reset runnableModels.ResetFunctionality.ResetStateMachine_instance_4.setDone runnableModels.ResetFunctionality.ResetStateMachine_instance_4.sm /end REF_MEASUREMENT
/end GROUP
/end MODULE
/end PROJECT
