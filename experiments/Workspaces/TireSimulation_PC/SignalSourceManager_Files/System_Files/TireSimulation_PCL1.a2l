ASAP2_VERSION 1 41
/begin PROJECT TireSimulation_PC "Generated by ETAS from Project TireSimulation_PC"
/begin HEADER "" VERSION "000" PROJECT_NO ASD /end HEADER
/begin MODULE TireSimulation_PC "Generated by ETAS ASCET7 from Project: TireSimulation_PC"
/begin IF_DATA E_TARGET
 /begin SOURCE "Task0" 3 /* period */ 1000 QP_BLOB 1 /end SOURCE
 /begin TP_BLOB /* programm id */ 1929403949 /* target id */ 7 0 2 0 /end TP_BLOB
/end IF_DATA
/begin MOD_PAR "" VERSION "000" ADDR_EPK 0x0 EPK "" SUPPLIER "ETAS GmbH" CUSTOMER "xxx" CUSTOMER_NO "000" USER "xxx" PHONE_NO "000" ECU "PC" CPU_TYPE "PCx86" NO_OF_INTERFACES 1 /end MOD_PAR
/begin MOD_COMMON "Common definitions" BYTE_ORDER MSB_LAST ALIGNMENT_BYTE 1 ALIGNMENT_WORD 2 ALIGNMENT_LONG 4 ALIGNMENT_FLOAT32_IEEE 4 ALIGNMENT_FLOAT64_IEEE 8 /end MOD_COMMON
/begin CHARACTERISTIC components.Simulation.vfr "" VALUE 0x451084 STANDARD_VALUE_R32 0.0 esdl_ident -3.4028234663852886E+38 3.4028234663852886E+38 /end CHARACTERISTIC
/begin CHARACTERISTIC components.Simulation.vfl "" VALUE 0x451080 STANDARD_VALUE_R32 0.0 esdl_ident -3.4028234663852886E+38 3.4028234663852886E+38 /end CHARACTERISTIC
/begin CHARACTERISTIC components.Simulation.vrr "" VALUE 0x45108C STANDARD_VALUE_R32 0.0 esdl_ident -3.4028234663852886E+38 3.4028234663852886E+38 /end CHARACTERISTIC
/begin CHARACTERISTIC components.Simulation.vrl "" VALUE 0x451088 STANDARD_VALUE_R32 0.0 esdl_ident -3.4028234663852886E+38 3.4028234663852886E+38 /end CHARACTERISTIC
/begin MEASUREMENT components.Simulation.sfl "" FLOAT32_IEEE esdl_ident 1 100.0 -3.4028234663852886E+38 3.4028234663852886E+38 ECU_ADDRESS 0x451060 /end MEASUREMENT
/begin MEASUREMENT components.Simulation.srl "" FLOAT32_IEEE esdl_ident 1 100.0 -3.4028234663852886E+38 3.4028234663852886E+38 ECU_ADDRESS 0x451068 /end MEASUREMENT
/begin MEASUREMENT components.Simulation.srr "" FLOAT32_IEEE esdl_ident 1 100.0 -3.4028234663852886E+38 3.4028234663852886E+38 ECU_ADDRESS 0x45106C /end MEASUREMENT
/begin MEASUREMENT components.Simulation.sfr "" FLOAT32_IEEE esdl_ident 1 100.0 -3.4028234663852886E+38 3.4028234663852886E+38 ECU_ADDRESS 0x451064 /end MEASUREMENT
/begin MEASUREMENT components.Simulation.Model_instance.sfl "" FLOAT32_IEEE esdl_ident 1 100.0 -3.4028234663852886E+38 3.4028234663852886E+38 ECU_ADDRESS 0x451070 /end MEASUREMENT
/begin MEASUREMENT components.Simulation.Model_instance.sfr "" FLOAT32_IEEE esdl_ident 1 100.0 -3.4028234663852886E+38 3.4028234663852886E+38 ECU_ADDRESS 0x451074 /end MEASUREMENT
/begin MEASUREMENT components.Simulation.Model_instance.srl "" FLOAT32_IEEE esdl_ident 1 100.0 -3.4028234663852886E+38 3.4028234663852886E+38 ECU_ADDRESS 0x451078 /end MEASUREMENT
/begin MEASUREMENT components.Simulation.Model_instance.srr "" FLOAT32_IEEE esdl_ident 1 100.0 -3.4028234663852886E+38 3.4028234663852886E+38 ECU_ADDRESS 0x45107C /end MEASUREMENT
/begin COMPU_METHOD esdl_ident "" RAT_FUNC /* format */ "%12.4" /* unit */ "" /* coeffs */ COEFFS 0 1 0 0 0 1 /end COMPU_METHOD
/begin FUNCTION TireSimulation_PC "" /begin SUB_FUNCTION components.Simulation components.Globals /end SUB_FUNCTION /end FUNCTION
/begin FUNCTION components.Simulation ""
 /begin DEF_CHARACTERISTIC components.Simulation.vfr components.Simulation.vfl components.Simulation.vrr components.Simulation.vrl /end DEF_CHARACTERISTIC
 /begin LOC_MEASUREMENT components.Simulation.sfl components.Simulation.sfr components.Simulation.srl components.Simulation.srr /end LOC_MEASUREMENT
 /begin SUB_FUNCTION components.Simulation.Model_instance /end SUB_FUNCTION
/end FUNCTION
/begin FUNCTION components.Simulation.Model_instance ""
 /begin LOC_MEASUREMENT components.Simulation.Model_instance.sfl components.Simulation.Model_instance.sfr components.Simulation.Model_instance.srl components.Simulation.Model_instance.srr /end LOC_MEASUREMENT
/end FUNCTION
/begin FUNCTION components.Globals "" /end FUNCTION
/begin RECORD_LAYOUT STANDARD_VALUE_R32 /* value */ FNC_VALUES 1 FLOAT32_IEEE COLUMN_DIR DIRECT /end RECORD_LAYOUT
/begin GROUP TireSimulation_PC "" ROOT /begin SUB_GROUP components.Simulation components.Globals /end SUB_GROUP /end GROUP
/begin GROUP components.Simulation ""
 /begin REF_CHARACTERISTIC components.Simulation.vfr components.Simulation.vfl components.Simulation.vrr components.Simulation.vrl /end REF_CHARACTERISTIC
 /begin REF_MEASUREMENT components.Simulation.sfl components.Simulation.sfr components.Simulation.srl components.Simulation.srr /end REF_MEASUREMENT
 /begin SUB_GROUP components.Simulation.Model_instance /end SUB_GROUP
/end GROUP
/begin GROUP components.Simulation.Model_instance ""
 /begin REF_MEASUREMENT components.Simulation.Model_instance.sfl components.Simulation.Model_instance.sfr components.Simulation.Model_instance.srl components.Simulation.Model_instance.srr /end REF_MEASUREMENT
/end GROUP
/begin GROUP components.Globals "" /end GROUP
/end MODULE
/end PROJECT
